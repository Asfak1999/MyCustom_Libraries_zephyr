## at24_eeprom_driver/build/Kconfig/soc/Kconfig.soc
```kconfig
# Load SoC Kconfig descriptions.
osource "D:/Zephyr_Projects/external/zephyr/soc/xlnx/zynqmp/Kconfig.soc"
osource "D:/Zephyr_Projects/external/zephyr/soc/xlnx/zynq7000/Kconfig.soc"
osource "D:/Zephyr_Projects/external/zephyr/soc/xlnx/versalnet/Kconfig.soc"
osource "D:/Zephyr_Projects/external/zephyr/soc/xlnx/versal2/Kconfig.soc"
osource "D:/Zephyr_Projects/external/zephyr/soc/xen/Kconfig.soc"
osource "D:/Zephyr_Projects/external/zephyr/soc/wch/ch32v/Kconfig.soc"
osource "D:/Zephyr_Projects/external/zephyr/soc/ti/simplelink/Kconfig.soc"
osource "D:/Zephyr_Projects/external/zephyr/soc/ti/mspm0/Kconfig.soc"
osource "D:/Zephyr_Projects/external/zephyr/soc/ti/lm3s6965/Kconfig.soc"
osource "D:/Zephyr_Projects/external/zephyr/soc/ti/k3/Kconfig.soc"
osource "D:/Zephyr_Projects/external/zephyr/soc/telink/tlsr/Kconfig.soc"
osource "D:/Zephyr_Projects/external/zephyr/soc/starfive/jh71xx/Kconfig.soc"
osource "D:/Zephyr_Projects/external/zephyr/soc/st/stm32/Kconfig.soc"
osource "D:/Zephyr_Projects/external/zephyr/soc/snps/qemu_arc/Kconfig.soc"
osource "D:/Zephyr_Projects/external/zephyr/soc/snps/nsim/arc_v/Kconfig.soc"
osource "D:/Zephyr_Projects/external/zephyr/soc/snps/nsim/arc_classic/Kconfig.soc"
osource "D:/Zephyr_Projects/external/zephyr/soc/snps/hsdk4xd/Kconfig.soc"
osource "D:/Zephyr_Projects/external/zephyr/soc/snps/hsdk/Kconfig.soc"
osource "D:/Zephyr_Projects/external/zephyr/soc/snps/emsk/Kconfig.soc"
osource "D:/Zephyr_Projects/external/zephyr/soc/snps/emsdp/Kconfig.soc"
osource "D:/Zephyr_Projects/external/zephyr/soc/snps/arc_iot/Kconfig.soc"
osource "D:/Zephyr_Projects/external/zephyr/soc/silabs/Kconfig.soc"
osource "D:/Zephyr_Projects/external/zephyr/soc/sifli/sf32/Kconfig.soc"
osource "D:/Zephyr_Projects/external/zephyr/soc/sifive/sifive_freedom/Kconfig.soc"
osource "D:/Zephyr_Projects/external/zephyr/soc/sensry/Kconfig.soc"
osource "D:/Zephyr_Projects/external/zephyr/soc/rockchip/Kconfig.soc"
osource "D:/Zephyr_Projects/external/zephyr/soc/renode/riscv_virtual/Kconfig.soc"
osource "D:/Zephyr_Projects/external/zephyr/soc/renode/cortex_r8_virtual/Kconfig.soc"
osource "D:/Zephyr_Projects/external/zephyr/soc/renesas/smartbond/Kconfig.soc"
osource "D:/Zephyr_Projects/external/zephyr/soc/renesas/rz/Kconfig.soc"
osource "D:/Zephyr_Projects/external/zephyr/soc/renesas/rx/Kconfig.soc"
osource "D:/Zephyr_Projects/external/zephyr/soc/renesas/rcar/Kconfig.soc"
osource "D:/Zephyr_Projects/external/zephyr/soc/renesas/ra/Kconfig.soc"
osource "D:/Zephyr_Projects/external/zephyr/soc/realtek/ec/Kconfig.soc"
osource "D:/Zephyr_Projects/external/zephyr/soc/raspberrypi/rpi_pico/Kconfig.soc"
osource "D:/Zephyr_Projects/external/zephyr/soc/quicklogic/eos_s3/Kconfig.soc"
osource "D:/Zephyr_Projects/external/zephyr/soc/qemu/virt_riscv/Kconfig.soc"
osource "D:/Zephyr_Projects/external/zephyr/soc/qemu/malta/Kconfig.soc"
osource "D:/Zephyr_Projects/external/zephyr/soc/openisa/rv32m1/Kconfig.soc"
osource "D:/Zephyr_Projects/external/zephyr/soc/openhwgroup/cva6/Kconfig.soc"
osource "D:/Zephyr_Projects/external/zephyr/soc/oct/osd32mp15x/Kconfig.soc"
osource "D:/Zephyr_Projects/external/zephyr/soc/nxp/s32/Kconfig.soc"
osource "D:/Zephyr_Projects/external/zephyr/soc/nxp/rw/Kconfig.soc"
osource "D:/Zephyr_Projects/external/zephyr/soc/nxp/mcx/Kconfig.soc"
osource "D:/Zephyr_Projects/external/zephyr/soc/nxp/lpc/Kconfig.soc"
osource "D:/Zephyr_Projects/external/zephyr/soc/nxp/layerscape/Kconfig.soc"
osource "D:/Zephyr_Projects/external/zephyr/soc/nxp/kinetis/Kconfig.soc"
osource "D:/Zephyr_Projects/external/zephyr/soc/nxp/imxrt/Kconfig.soc"
osource "D:/Zephyr_Projects/external/zephyr/soc/nxp/imx/Kconfig.soc"
osource "D:/Zephyr_Projects/external/zephyr/soc/nuvoton/numicro/Kconfig.soc"
osource "D:/Zephyr_Projects/external/zephyr/soc/nuvoton/numaker/Kconfig.soc"
osource "D:/Zephyr_Projects/external/zephyr/soc/nuvoton/npcx/Kconfig.soc"
osource "D:/Zephyr_Projects/external/zephyr/soc/nuvoton/npcm/Kconfig.soc"
osource "D:/Zephyr_Projects/external/zephyr/soc/nordic/Kconfig.soc"
osource "D:/Zephyr_Projects/external/zephyr/soc/neorv32/Kconfig.soc"
osource "D:/Zephyr_Projects/external/zephyr/soc/native/inf_clock/Kconfig.soc"
osource "D:/Zephyr_Projects/external/zephyr/soc/microchip/sam/Kconfig.soc"
osource "D:/Zephyr_Projects/external/zephyr/soc/microchip/sam/sama7/Kconfig.soc"
osource "D:/Zephyr_Projects/external/zephyr/soc/microchip/sam/sam_d5x_e5x/Kconfig.soc"
osource "D:/Zephyr_Projects/external/zephyr/soc/microchip/pic32c/pic32cz_ca/Kconfig.soc"
osource "D:/Zephyr_Projects/external/zephyr/soc/microchip/pic32c/pic32cx_sg/Kconfig.soc"
osource "D:/Zephyr_Projects/external/zephyr/soc/microchip/pic32c/pic32cm_jh/Kconfig.soc"
osource "D:/Zephyr_Projects/external/zephyr/soc/microchip/miv/Kconfig.soc"
osource "D:/Zephyr_Projects/external/zephyr/soc/microchip/mec/Kconfig.soc"
osource "D:/Zephyr_Projects/external/zephyr/soc/mediatek/mt8xxx/Kconfig.soc"
osource "D:/Zephyr_Projects/external/zephyr/soc/lowrisc/opentitan/Kconfig.soc"
osource "D:/Zephyr_Projects/external/zephyr/soc/litex/litex_vexriscv/Kconfig.soc"
osource "D:/Zephyr_Projects/external/zephyr/soc/ite/ec/Kconfig.soc"
osource "D:/Zephyr_Projects/external/zephyr/soc/intel/raptor_lake/Kconfig.soc"
osource "D:/Zephyr_Projects/external/zephyr/soc/intel/panther_lake/Kconfig.soc"
osource "D:/Zephyr_Projects/external/zephyr/soc/intel/lakemont/Kconfig.soc"
osource "D:/Zephyr_Projects/external/zephyr/soc/intel/intel_socfpga_std/Kconfig.soc"
osource "D:/Zephyr_Projects/external/zephyr/soc/intel/intel_socfpga/Kconfig.soc"
osource "D:/Zephyr_Projects/external/zephyr/soc/intel/intel_niosv/Kconfig.soc"
osource "D:/Zephyr_Projects/external/zephyr/soc/intel/intel_ish/Kconfig.soc"
osource "D:/Zephyr_Projects/external/zephyr/soc/intel/intel_adsp/Kconfig.soc"
osource "D:/Zephyr_Projects/external/zephyr/soc/intel/elkhart_lake/Kconfig.soc"
osource "D:/Zephyr_Projects/external/zephyr/soc/intel/atom/Kconfig.soc"
osource "D:/Zephyr_Projects/external/zephyr/soc/intel/apollo_lake/Kconfig.soc"
osource "D:/Zephyr_Projects/external/zephyr/soc/intel/alder_lake/Kconfig.soc"
osource "D:/Zephyr_Projects/external/zephyr/soc/infineon/edge/Kconfig.soc"
osource "D:/Zephyr_Projects/external/zephyr/soc/infineon/cat3/Kconfig.soc"
osource "D:/Zephyr_Projects/external/zephyr/soc/infineon/cat1c/Kconfig.soc"
osource "D:/Zephyr_Projects/external/zephyr/soc/infineon/cat1b/Kconfig.soc"
osource "D:/Zephyr_Projects/external/zephyr/soc/infineon/cat1a/Kconfig.soc"
osource "D:/Zephyr_Projects/external/zephyr/soc/gd/gd32/Kconfig.soc"
osource "D:/Zephyr_Projects/external/zephyr/soc/gaisler/leon3/Kconfig.soc"
osource "D:/Zephyr_Projects/external/zephyr/soc/gaisler/gr716a/Kconfig.soc"
osource "D:/Zephyr_Projects/external/zephyr/soc/espressif/Kconfig.soc"
osource "D:/Zephyr_Projects/external/zephyr/soc/ene/kb1200/Kconfig.soc"
osource "D:/Zephyr_Projects/external/zephyr/soc/ene/kb106x/Kconfig.soc"
osource "D:/Zephyr_Projects/external/zephyr/soc/egis/Kconfig.soc"
osource "D:/Zephyr_Projects/external/zephyr/soc/efinix/sapphire/Kconfig.soc"
osource "D:/Zephyr_Projects/external/zephyr/soc/cdns/xtensa_sample_controller/Kconfig.soc"
osource "D:/Zephyr_Projects/external/zephyr/soc/cdns/sample_controller32/Kconfig.soc"
osource "D:/Zephyr_Projects/external/zephyr/soc/cdns/dc233c/Kconfig.soc"
osource "D:/Zephyr_Projects/external/zephyr/soc/brcm/bcmvk/Kconfig.soc"
osource "D:/Zephyr_Projects/external/zephyr/soc/brcm/bcm2712/Kconfig.soc"
osource "D:/Zephyr_Projects/external/zephyr/soc/brcm/bcm2711/Kconfig.soc"
osource "D:/Zephyr_Projects/external/zephyr/soc/bflb/Kconfig.soc"
osource "D:/Zephyr_Projects/external/zephyr/soc/atmel/sam0/Kconfig.soc"
osource "D:/Zephyr_Projects/external/zephyr/soc/atmel/sam/Kconfig.soc"
osource "D:/Zephyr_Projects/external/zephyr/soc/aspeed/Kconfig.soc"
osource "D:/Zephyr_Projects/external/zephyr/soc/arm/Kconfig.soc"
osource "D:/Zephyr_Projects/external/zephyr/soc/arm/beetle/Kconfig.soc"
osource "D:/Zephyr_Projects/external/zephyr/soc/antmicro/myra/Kconfig.soc"
osource "D:/Zephyr_Projects/external/zephyr/soc/andestech/Kconfig.soc"
osource "D:/Zephyr_Projects/external/zephyr/soc/amd/acp_6_0/Kconfig.soc"
osource "D:/Zephyr_Projects/external/zephyr/soc/ambiq/Kconfig.soc"
osource "D:/Zephyr_Projects/external/zephyr/soc/aesc/Kconfig.soc"
osource "D:/Zephyr_Projects/external/zephyr/soc/adi/max32/Kconfig.soc"
```
