## at24_eeprom_driver/build/Kconfig/soc/Kconfig.soc.tmp
```kconfig
# Load SoC Kconfig descriptions.
osource "G:/Zephyr_Projects/zephyr/soc/xlnx/zynqmp/Kconfig.soc"
osource "G:/Zephyr_Projects/zephyr/soc/xlnx/zynq7000/Kconfig.soc"
osource "G:/Zephyr_Projects/zephyr/soc/xlnx/versalnet/Kconfig.soc"
osource "G:/Zephyr_Projects/zephyr/soc/xlnx/versal2/Kconfig.soc"
osource "G:/Zephyr_Projects/zephyr/soc/xlnx/versal/Kconfig.soc"
osource "G:/Zephyr_Projects/zephyr/soc/xen/Kconfig.soc"
osource "G:/Zephyr_Projects/zephyr/soc/wch/ch32v/Kconfig.soc"
osource "G:/Zephyr_Projects/zephyr/soc/ti/simplelink/Kconfig.soc"
osource "G:/Zephyr_Projects/zephyr/soc/ti/mspm0/Kconfig.soc"
osource "G:/Zephyr_Projects/zephyr/soc/ti/lm3s6965/Kconfig.soc"
osource "G:/Zephyr_Projects/zephyr/soc/ti/k3/Kconfig.soc"
osource "G:/Zephyr_Projects/zephyr/soc/telink/tlsr/Kconfig.soc"
osource "G:/Zephyr_Projects/zephyr/soc/starfive/jh71xx/Kconfig.soc"
osource "G:/Zephyr_Projects/zephyr/soc/st/stm32/Kconfig.soc"
osource "G:/Zephyr_Projects/zephyr/soc/snps/qemu_arc/Kconfig.soc"
osource "G:/Zephyr_Projects/zephyr/soc/snps/nsim/arc_v/Kconfig.soc"
osource "G:/Zephyr_Projects/zephyr/soc/snps/nsim/arc_classic/Kconfig.soc"
osource "G:/Zephyr_Projects/zephyr/soc/snps/hsdk4xd/Kconfig.soc"
osource "G:/Zephyr_Projects/zephyr/soc/snps/hsdk/Kconfig.soc"
osource "G:/Zephyr_Projects/zephyr/soc/snps/emsk/Kconfig.soc"
osource "G:/Zephyr_Projects/zephyr/soc/snps/emsdp/Kconfig.soc"
osource "G:/Zephyr_Projects/zephyr/soc/snps/arc_iot/Kconfig.soc"
osource "G:/Zephyr_Projects/zephyr/soc/silabs/Kconfig.soc"
osource "G:/Zephyr_Projects/zephyr/soc/sifli/sf32/Kconfig.soc"
osource "G:/Zephyr_Projects/zephyr/soc/sifive/sifive_freedom/Kconfig.soc"
osource "G:/Zephyr_Projects/zephyr/soc/sensry/Kconfig.soc"
osource "G:/Zephyr_Projects/zephyr/soc/rockchip/Kconfig.soc"
osource "G:/Zephyr_Projects/zephyr/soc/renode/riscv_virtual/Kconfig.soc"
osource "G:/Zephyr_Projects/zephyr/soc/renode/cortex_r8_virtual/Kconfig.soc"
osource "G:/Zephyr_Projects/zephyr/soc/renesas/smartbond/Kconfig.soc"
osource "G:/Zephyr_Projects/zephyr/soc/renesas/rz/Kconfig.soc"
osource "G:/Zephyr_Projects/zephyr/soc/renesas/rx/Kconfig.soc"
osource "G:/Zephyr_Projects/zephyr/soc/renesas/rcar/Kconfig.soc"
osource "G:/Zephyr_Projects/zephyr/soc/renesas/ra/Kconfig.soc"
osource "G:/Zephyr_Projects/zephyr/soc/realtek/fingerprint/Kconfig.soc"
osource "G:/Zephyr_Projects/zephyr/soc/realtek/ec/Kconfig.soc"
osource "G:/Zephyr_Projects/zephyr/soc/realtek/bee/Kconfig.soc"
osource "G:/Zephyr_Projects/zephyr/soc/realtek/ameba/Kconfig.soc"
osource "G:/Zephyr_Projects/zephyr/soc/raspberrypi/rpi_pico/Kconfig.soc"
osource "G:/Zephyr_Projects/zephyr/soc/quicklogic/eos_s3/Kconfig.soc"
osource "G:/Zephyr_Projects/zephyr/soc/qemu/virt_riscv/Kconfig.soc"
osource "G:/Zephyr_Projects/zephyr/soc/qemu/malta/Kconfig.soc"
osource "G:/Zephyr_Projects/zephyr/soc/openisa/rv32m1/Kconfig.soc"
osource "G:/Zephyr_Projects/zephyr/soc/openhwgroup/cva6/Kconfig.soc"
osource "G:/Zephyr_Projects/zephyr/soc/oct/osd32mp15x/Kconfig.soc"
osource "G:/Zephyr_Projects/zephyr/soc/nxp/s32/Kconfig.soc"
osource "G:/Zephyr_Projects/zephyr/soc/nxp/rw/Kconfig.soc"
osource "G:/Zephyr_Projects/zephyr/soc/nxp/mcx/Kconfig.soc"
osource "G:/Zephyr_Projects/zephyr/soc/nxp/lpc/Kconfig.soc"
osource "G:/Zephyr_Projects/zephyr/soc/nxp/layerscape/Kconfig.soc"
osource "G:/Zephyr_Projects/zephyr/soc/nxp/kinetis/Kconfig.soc"
osource "G:/Zephyr_Projects/zephyr/soc/nxp/imxrt/Kconfig.soc"
osource "G:/Zephyr_Projects/zephyr/soc/nxp/imx/Kconfig.soc"
osource "G:/Zephyr_Projects/zephyr/soc/nuvoton/numicro/Kconfig.soc"
osource "G:/Zephyr_Projects/zephyr/soc/nuvoton/numaker/Kconfig.soc"
osource "G:/Zephyr_Projects/zephyr/soc/nuvoton/npcx/Kconfig.soc"
osource "G:/Zephyr_Projects/zephyr/soc/nuvoton/npcm/Kconfig.soc"
osource "G:/Zephyr_Projects/zephyr/soc/nordic/Kconfig.soc"
osource "G:/Zephyr_Projects/zephyr/soc/neorv32/Kconfig.soc"
osource "G:/Zephyr_Projects/zephyr/soc/native/inf_clock/Kconfig.soc"
osource "G:/Zephyr_Projects/zephyr/soc/microchip/sam/sama7/Kconfig.soc"
osource "G:/Zephyr_Projects/zephyr/soc/microchip/sam/sam_d5x_e5x/Kconfig.soc"
osource "G:/Zephyr_Projects/zephyr/soc/microchip/pic64/Kconfig.soc"
osource "G:/Zephyr_Projects/zephyr/soc/microchip/pic32c/pic32cz_ca/Kconfig.soc"
osource "G:/Zephyr_Projects/zephyr/soc/microchip/pic32c/pic32cx_sg/Kconfig.soc"
osource "G:/Zephyr_Projects/zephyr/soc/microchip/pic32c/pic32cm_pl/Kconfig.soc"
osource "G:/Zephyr_Projects/zephyr/soc/microchip/pic32c/pic32cm_jh/Kconfig.soc"
osource "G:/Zephyr_Projects/zephyr/soc/microchip/miv/Kconfig.soc"
osource "G:/Zephyr_Projects/zephyr/soc/microchip/mec/Kconfig.soc"
osource "G:/Zephyr_Projects/zephyr/soc/mediatek/mt8xxx/Kconfig.soc"
osource "G:/Zephyr_Projects/zephyr/soc/lowrisc/opentitan/Kconfig.soc"
osource "G:/Zephyr_Projects/zephyr/soc/litex/litex_vexriscv/Kconfig.soc"
osource "G:/Zephyr_Projects/zephyr/soc/ite/ec/Kconfig.soc"
osource "G:/Zephyr_Projects/zephyr/soc/intel/wildcat_lake/Kconfig.soc"
osource "G:/Zephyr_Projects/zephyr/soc/intel/raptor_lake/Kconfig.soc"
osource "G:/Zephyr_Projects/zephyr/soc/intel/panther_lake/Kconfig.soc"
osource "G:/Zephyr_Projects/zephyr/soc/intel/lakemont/Kconfig.soc"
osource "G:/Zephyr_Projects/zephyr/soc/intel/intel_socfpga_std/Kconfig.soc"
osource "G:/Zephyr_Projects/zephyr/soc/intel/intel_socfpga/Kconfig.soc"
osource "G:/Zephyr_Projects/zephyr/soc/intel/intel_niosv/Kconfig.soc"
osource "G:/Zephyr_Projects/zephyr/soc/intel/intel_ish/Kconfig.soc"
osource "G:/Zephyr_Projects/zephyr/soc/intel/intel_adsp/Kconfig.soc"
osource "G:/Zephyr_Projects/zephyr/soc/intel/elkhart_lake/Kconfig.soc"
osource "G:/Zephyr_Projects/zephyr/soc/intel/atom/Kconfig.soc"
osource "G:/Zephyr_Projects/zephyr/soc/intel/apollo_lake/Kconfig.soc"
osource "G:/Zephyr_Projects/zephyr/soc/intel/alder_lake/Kconfig.soc"
osource "G:/Zephyr_Projects/zephyr/soc/infineon/psoc4/Kconfig.soc"
osource "G:/Zephyr_Projects/zephyr/soc/infineon/edge/Kconfig.soc"
osource "G:/Zephyr_Projects/zephyr/soc/infineon/cat3/Kconfig.soc"
osource "G:/Zephyr_Projects/zephyr/soc/infineon/cat1c/Kconfig.soc"
osource "G:/Zephyr_Projects/zephyr/soc/infineon/cat1b/Kconfig.soc"
osource "G:/Zephyr_Projects/zephyr/soc/infineon/cat1a/Kconfig.soc"
osource "G:/Zephyr_Projects/zephyr/soc/gd/gd32/Kconfig.soc"
osource "G:/Zephyr_Projects/zephyr/soc/gaisler/leon3/Kconfig.soc"
osource "G:/Zephyr_Projects/zephyr/soc/gaisler/gr716a/Kconfig.soc"
osource "G:/Zephyr_Projects/zephyr/soc/focaltech/Kconfig.soc"
osource "G:/Zephyr_Projects/zephyr/soc/espressif/Kconfig.soc"
osource "G:/Zephyr_Projects/zephyr/soc/ene/kb1200/Kconfig.soc"
osource "G:/Zephyr_Projects/zephyr/soc/ene/kb106x/Kconfig.soc"
osource "G:/Zephyr_Projects/zephyr/soc/elan/em32f967/Kconfig.soc"
osource "G:/Zephyr_Projects/zephyr/soc/egis/Kconfig.soc"
osource "G:/Zephyr_Projects/zephyr/soc/efinix/sapphire/Kconfig.soc"
osource "G:/Zephyr_Projects/zephyr/soc/cdns/xtensa_sample_controller/Kconfig.soc"
osource "G:/Zephyr_Projects/zephyr/soc/cdns/sample_controller32/Kconfig.soc"
osource "G:/Zephyr_Projects/zephyr/soc/cdns/dc233c/Kconfig.soc"
osource "G:/Zephyr_Projects/zephyr/soc/brcm/bcmvk/Kconfig.soc"
osource "G:/Zephyr_Projects/zephyr/soc/brcm/bcm2712/Kconfig.soc"
osource "G:/Zephyr_Projects/zephyr/soc/brcm/bcm2711/Kconfig.soc"
osource "G:/Zephyr_Projects/zephyr/soc/blackberry/qnxhv_vm/Kconfig.soc"
osource "G:/Zephyr_Projects/zephyr/soc/bflb/Kconfig.soc"
osource "G:/Zephyr_Projects/zephyr/soc/atmel/sam0/Kconfig.soc"
osource "G:/Zephyr_Projects/zephyr/soc/atmel/sam/Kconfig.soc"
osource "G:/Zephyr_Projects/zephyr/soc/aspeed/Kconfig.soc"
osource "G:/Zephyr_Projects/zephyr/soc/arm/Kconfig.soc"
osource "G:/Zephyr_Projects/zephyr/soc/arm/beetle/Kconfig.soc"
osource "G:/Zephyr_Projects/zephyr/soc/antmicro/myra/Kconfig.soc"
osource "G:/Zephyr_Projects/zephyr/soc/andestech/Kconfig.soc"
osource "G:/Zephyr_Projects/zephyr/soc/amd/acp_6_0/Kconfig.soc"
osource "G:/Zephyr_Projects/zephyr/soc/ambiq/Kconfig.soc"
osource "G:/Zephyr_Projects/zephyr/soc/allwinner/sun8i_h3/Kconfig.soc"
osource "G:/Zephyr_Projects/zephyr/soc/alif/ensemble/Kconfig.soc"
osource "G:/Zephyr_Projects/zephyr/soc/aesc/Kconfig.soc"
osource "G:/Zephyr_Projects/zephyr/soc/adi/max32/Kconfig.soc"
```
