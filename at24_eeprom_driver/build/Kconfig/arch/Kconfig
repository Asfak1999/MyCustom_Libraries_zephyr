## at24_eeprom_driver/build/Kconfig/soc/Kconfig.defconfig
```kconfig
# Load Zephyr SoC defconfig descriptions.
osource "D:/Zephyr_Projects/external/zephyr/soc/xlnx/zynqmp/Kconfig.defconfig"
osource "D:/Zephyr_Projects/external/zephyr/soc/xlnx/zynq7000/Kconfig.defconfig"
osource "D:/Zephyr_Projects/external/zephyr/soc/xlnx/versalnet/Kconfig.defconfig"
osource "D:/Zephyr_Projects/external/zephyr/soc/xlnx/versal2/Kconfig.defconfig"
osource "D:/Zephyr_Projects/external/zephyr/soc/xen/Kconfig.defconfig"
osource "D:/Zephyr_Projects/external/zephyr/soc/wch/ch32v/Kconfig.defconfig"
osource "D:/Zephyr_Projects/external/zephyr/soc/ti/simplelink/Kconfig.defconfig"
osource "D:/Zephyr_Projects/external/zephyr/soc/ti/mspm0/Kconfig.defconfig"
osource "D:/Zephyr_Projects/external/zephyr/soc/ti/lm3s6965/Kconfig.defconfig"
osource "D:/Zephyr_Projects/external/zephyr/soc/ti/k3/Kconfig.defconfig"
osource "D:/Zephyr_Projects/external/zephyr/soc/telink/tlsr/Kconfig.defconfig"
osource "D:/Zephyr_Projects/external/zephyr/soc/starfive/jh71xx/Kconfig.defconfig"
osource "D:/Zephyr_Projects/external/zephyr/soc/st/stm32/Kconfig.defconfig"
osource "D:/Zephyr_Projects/external/zephyr/soc/snps/qemu_arc/Kconfig.defconfig"
osource "D:/Zephyr_Projects/external/zephyr/soc/snps/nsim/arc_v/Kconfig.defconfig"
osource "D:/Zephyr_Projects/external/zephyr/soc/snps/nsim/arc_classic/Kconfig.defconfig"
osource "D:/Zephyr_Projects/external/zephyr/soc/snps/hsdk4xd/Kconfig.defconfig"
osource "D:/Zephyr_Projects/external/zephyr/soc/snps/hsdk/Kconfig.defconfig"
osource "D:/Zephyr_Projects/external/zephyr/soc/snps/emsk/Kconfig.defconfig"
osource "D:/Zephyr_Projects/external/zephyr/soc/snps/emsdp/Kconfig.defconfig"
osource "D:/Zephyr_Projects/external/zephyr/soc/snps/arc_iot/Kconfig.defconfig"
osource "D:/Zephyr_Projects/external/zephyr/soc/silabs/Kconfig.defconfig"
osource "D:/Zephyr_Projects/external/zephyr/soc/sifli/sf32/Kconfig.defconfig"
osource "D:/Zephyr_Projects/external/zephyr/soc/sifive/sifive_freedom/Kconfig.defconfig"
osource "D:/Zephyr_Projects/external/zephyr/soc/sensry/Kconfig.defconfig"
osource "D:/Zephyr_Projects/external/zephyr/soc/rockchip/Kconfig.defconfig"
osource "D:/Zephyr_Projects/external/zephyr/soc/renode/riscv_virtual/Kconfig.defconfig"
osource "D:/Zephyr_Projects/external/zephyr/soc/renode/cortex_r8_virtual/Kconfig.defconfig"
osource "D:/Zephyr_Projects/external/zephyr/soc/renesas/smartbond/Kconfig.defconfig"
osource "D:/Zephyr_Projects/external/zephyr/soc/renesas/rz/Kconfig.defconfig"
osource "D:/Zephyr_Projects/external/zephyr/soc/renesas/rx/Kconfig.defconfig"
osource "D:/Zephyr_Projects/external/zephyr/soc/renesas/rcar/Kconfig.defconfig"
osource "D:/Zephyr_Projects/external/zephyr/soc/renesas/ra/Kconfig.defconfig"
osource "D:/Zephyr_Projects/external/zephyr/soc/realtek/ec/Kconfig.defconfig"
osource "D:/Zephyr_Projects/external/zephyr/soc/raspberrypi/rpi_pico/Kconfig.defconfig"
osource "D:/Zephyr_Projects/external/zephyr/soc/quicklogic/eos_s3/Kconfig.defconfig"
osource "D:/Zephyr_Projects/external/zephyr/soc/qemu/virt_riscv/Kconfig.defconfig"
osource "D:/Zephyr_Projects/external/zephyr/soc/qemu/malta/Kconfig.defconfig"
osource "D:/Zephyr_Projects/external/zephyr/soc/openisa/rv32m1/Kconfig.defconfig"
osource "D:/Zephyr_Projects/external/zephyr/soc/openhwgroup/cva6/Kconfig.defconfig"
osource "D:/Zephyr_Projects/external/zephyr/soc/oct/osd32mp15x/Kconfig.defconfig"
osource "D:/Zephyr_Projects/external/zephyr/soc/nxp/s32/Kconfig.defconfig"
osource "D:/Zephyr_Projects/external/zephyr/soc/nxp/rw/Kconfig.defconfig"
osource "D:/Zephyr_Projects/external/zephyr/soc/nxp/mcx/Kconfig.defconfig"
osource "D:/Zephyr_Projects/external/zephyr/soc/nxp/lpc/Kconfig.defconfig"
osource "D:/Zephyr_Projects/external/zephyr/soc/nxp/layerscape/Kconfig.defconfig"
osource "D:/Zephyr_Projects/external/zephyr/soc/nxp/kinetis/Kconfig.defconfig"
osource "D:/Zephyr_Projects/external/zephyr/soc/nxp/imxrt/Kconfig.defconfig"
osource "D:/Zephyr_Projects/external/zephyr/soc/nxp/imx/Kconfig.defconfig"
osource "D:/Zephyr_Projects/external/zephyr/soc/nuvoton/numicro/Kconfig.defconfig"
osource "D:/Zephyr_Projects/external/zephyr/soc/nuvoton/numaker/Kconfig.defconfig"
osource "D:/Zephyr_Projects/external/zephyr/soc/nuvoton/npcx/Kconfig.defconfig"
osource "D:/Zephyr_Projects/external/zephyr/soc/nuvoton/npcm/Kconfig.defconfig"
osource "D:/Zephyr_Projects/external/zephyr/soc/nordic/Kconfig.defconfig"
osource "D:/Zephyr_Projects/external/zephyr/soc/neorv32/Kconfig.defconfig"
osource "D:/Zephyr_Projects/external/zephyr/soc/native/inf_clock/Kconfig.defconfig"
osource "D:/Zephyr_Projects/external/zephyr/soc/microchip/sam/Kconfig.defconfig"
osource "D:/Zephyr_Projects/external/zephyr/soc/microchip/sam/sama7/Kconfig.defconfig"
osource "D:/Zephyr_Projects/external/zephyr/soc/microchip/sam/sam_d5x_e5x/Kconfig.defconfig"
osource "D:/Zephyr_Projects/external/zephyr/soc/microchip/pic32c/pic32cz_ca/Kconfig.defconfig"
osource "D:/Zephyr_Projects/external/zephyr/soc/microchip/pic32c/pic32cx_sg/Kconfig.defconfig"
osource "D:/Zephyr_Projects/external/zephyr/soc/microchip/pic32c/pic32cm_jh/Kconfig.defconfig"
osource "D:/Zephyr_Projects/external/zephyr/soc/microchip/miv/Kconfig.defconfig"
osource "D:/Zephyr_Projects/external/zephyr/soc/microchip/mec/Kconfig.defconfig"
osource "D:/Zephyr_Projects/external/zephyr/soc/mediatek/mt8xxx/Kconfig.defconfig"
osource "D:/Zephyr_Projects/external/zephyr/soc/lowrisc/opentitan/Kconfig.defconfig"
osource "D:/Zephyr_Projects/external/zephyr/soc/litex/litex_vexriscv/Kconfig.defconfig"
osource "D:/Zephyr_Projects/external/zephyr/soc/ite/ec/Kconfig.defconfig"
osource "D:/Zephyr_Projects/external/zephyr/soc/intel/raptor_lake/Kconfig.defconfig"
osource "D:/Zephyr_Projects/external/zephyr/soc/intel/panther_lake/Kconfig.defconfig"
osource "D:/Zephyr_Projects/external/zephyr/soc/intel/lakemont/Kconfig.defconfig"
osource "D:/Zephyr_Projects/external/zephyr/soc/intel/intel_socfpga_std/Kconfig.defconfig"
osource "D:/Zephyr_Projects/external/zephyr/soc/intel/intel_socfpga/Kconfig.defconfig"
osource "D:/Zephyr_Projects/external/zephyr/soc/intel/intel_niosv/Kconfig.defconfig"
osource "D:/Zephyr_Projects/external/zephyr/soc/intel/intel_ish/Kconfig.defconfig"
osource "D:/Zephyr_Projects/external/zephyr/soc/intel/intel_adsp/Kconfig.defconfig"
osource "D:/Zephyr_Projects/external/zephyr/soc/intel/elkhart_lake/Kconfig.defconfig"
osource "D:/Zephyr_Projects/external/zephyr/soc/intel/atom/Kconfig.defconfig"
osource "D:/Zephyr_Projects/external/zephyr/soc/intel/apollo_lake/Kconfig.defconfig"
osource "D:/Zephyr_Projects/external/zephyr/soc/intel/alder_lake/Kconfig.defconfig"
osource "D:/Zephyr_Projects/external/zephyr/soc/infineon/edge/Kconfig.defconfig"
osource "D:/Zephyr_Projects/external/zephyr/soc/infineon/cat3/Kconfig.defconfig"
osource "D:/Zephyr_Projects/external/zephyr/soc/infineon/cat1c/Kconfig.defconfig"
osource "D:/Zephyr_Projects/external/zephyr/soc/infineon/cat1b/Kconfig.defconfig"
osource "D:/Zephyr_Projects/external/zephyr/soc/infineon/cat1a/Kconfig.defconfig"
osource "D:/Zephyr_Projects/external/zephyr/soc/gd/gd32/Kconfig.defconfig"
osource "D:/Zephyr_Projects/external/zephyr/soc/gaisler/leon3/Kconfig.defconfig"
osource "D:/Zephyr_Projects/external/zephyr/soc/gaisler/gr716a/Kconfig.defconfig"
osource "D:/Zephyr_Projects/external/zephyr/soc/espressif/Kconfig.defconfig"
osource "D:/Zephyr_Projects/external/zephyr/soc/ene/kb1200/Kconfig.defconfig"
osource "D:/Zephyr_Projects/external/zephyr/soc/ene/kb106x/Kconfig.defconfig"
osource "D:/Zephyr_Projects/external/zephyr/soc/egis/Kconfig.defconfig"
osource "D:/Zephyr_Projects/external/zephyr/soc/efinix/sapphire/Kconfig.defconfig"
osource "D:/Zephyr_Projects/external/zephyr/soc/cdns/xtensa_sample_controller/Kconfig.defconfig"
osource "D:/Zephyr_Projects/external/zephyr/soc/cdns/sample_controller32/Kconfig.defconfig"
osource "D:/Zephyr_Projects/external/zephyr/soc/cdns/dc233c/Kconfig.defconfig"
osource "D:/Zephyr_Projects/external/zephyr/soc/brcm/bcmvk/Kconfig.defconfig"
osource "D:/Zephyr_Projects/external/zephyr/soc/brcm/bcm2712/Kconfig.defconfig"
osource "D:/Zephyr_Projects/external/zephyr/soc/brcm/bcm2711/Kconfig.defconfig"
osource "D:/Zephyr_Projects/external/zephyr/soc/bflb/Kconfig.defconfig"
osource "D:/Zephyr_Projects/external/zephyr/soc/atmel/sam0/Kconfig.defconfig"
osource "D:/Zephyr_Projects/external/zephyr/soc/atmel/sam/Kconfig.defconfig"
osource "D:/Zephyr_Projects/external/zephyr/soc/aspeed/Kconfig.defconfig"
osource "D:/Zephyr_Projects/external/zephyr/soc/arm/Kconfig.defconfig"
osource "D:/Zephyr_Projects/external/zephyr/soc/arm/beetle/Kconfig.defconfig"
osource "D:/Zephyr_Projects/external/zephyr/soc/antmicro/myra/Kconfig.defconfig"
osource "D:/Zephyr_Projects/external/zephyr/soc/andestech/Kconfig.defconfig"
osource "D:/Zephyr_Projects/external/zephyr/soc/amd/acp_6_0/Kconfig.defconfig"
osource "D:/Zephyr_Projects/external/zephyr/soc/ambiq/Kconfig.defconfig"
osource "D:/Zephyr_Projects/external/zephyr/soc/aesc/Kconfig.defconfig"
osource "D:/Zephyr_Projects/external/zephyr/soc/adi/max32/Kconfig.defconfig"
```
