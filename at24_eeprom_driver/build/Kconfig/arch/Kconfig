## at24_eeprom_driver/build/Kconfig/arch/Kconfig
```kconfig
# Load Zephyr Arch Kconfig descriptions.
osource "D:/Zephyr_Projects/external/zephyr/arch/rx/Kconfig"
osource "D:/Zephyr_Projects/external/zephyr/arch/x86/Kconfig"
osource "D:/Zephyr_Projects/external/zephyr/arch/xtensa/Kconfig"
osource "D:/Zephyr_Projects/external/zephyr/arch/sparc/Kconfig"
osource "D:/Zephyr_Projects/external/zephyr/arch/riscv/Kconfig"
osource "D:/Zephyr_Projects/external/zephyr/arch/posix/Kconfig"
osource "D:/Zephyr_Projects/external/zephyr/arch/mips/Kconfig"
osource "D:/Zephyr_Projects/external/zephyr/arch/arm64/Kconfig"
osource "D:/Zephyr_Projects/external/zephyr/arch/arm/Kconfig"
osource "D:/Zephyr_Projects/external/zephyr/arch/arc/Kconfig"
```

## at24_eeprom_driver/build/Kconfig/arch/Kconfig.tmp
```kconfig
# Load Zephyr Arch Kconfig descriptions.
osource "G:/Zephyr_Projects/zephyr/arch/rx/Kconfig"
osource "G:/Zephyr_Projects/zephyr/arch/x86/Kconfig"
osource "G:/Zephyr_Projects/zephyr/arch/xtensa/Kconfig"
osource "G:/Zephyr_Projects/zephyr/arch/sparc/Kconfig"
osource "G:/Zephyr_Projects/zephyr/arch/riscv/Kconfig"
osource "G:/Zephyr_Projects/zephyr/arch/posix/Kconfig"
osource "G:/Zephyr_Projects/zephyr/arch/mips/Kconfig"
osource "G:/Zephyr_Projects/zephyr/arch/arm64/Kconfig"
osource "G:/Zephyr_Projects/zephyr/arch/arm/Kconfig"
osource "G:/Zephyr_Projects/zephyr/arch/arc/Kconfig"
```

## at24_eeprom_driver/build/Kconfig/boards/Kconfig
```kconfig
# Load Zephyr board Kconfig descriptions.
osource "D:/Zephyr_Projects/external/zephyr/boards/st/stm32f4_disco/Kconfig"
```

## at24_eeprom_driver/build/Kconfig/boards/Kconfig.defconfig
```kconfig
# Load Zephyr board defconfig descriptions.
osource "D:/Zephyr_Projects/external/zephyr/boards/st/stm32f4_disco/Kconfig.defconfig"
```

## at24_eeprom_driver/build/Kconfig/boards/Kconfig.defconfig.tmp
```kconfig
# Load Zephyr board defconfig descriptions.
osource "G:/Zephyr_Projects/zephyr/boards/st/stm32f4_disco/Kconfig.defconfig"
```

## at24_eeprom_driver/build/Kconfig/boards/Kconfig.stm32f4_disco
```kconfig
# Load board Kconfig descriptions.
osource "D:/Zephyr_Projects/external/zephyr/boards/st/stm32f4_disco/Kconfig.stm32f4_disco"
```

## at24_eeprom_driver/build/Kconfig/boards/Kconfig.stm32f4_disco.tmp
```kconfig
# Load board Kconfig descriptions.
osource "G:/Zephyr_Projects/zephyr/boards/st/stm32f4_disco/Kconfig.stm32f4_disco"
```

## at24_eeprom_driver/build/Kconfig/boards/Kconfig.sysbuild
```kconfig
# Load Sysbuild board Kconfig descriptions.
osource "D:/Zephyr_Projects/external/zephyr/boards/st/stm32f4_disco/Kconfig.sysbuild"
```

## at24_eeprom_driver/build/Kconfig/boards/Kconfig.sysbuild.tmp
```kconfig
# Load Sysbuild board Kconfig descriptions.
osource "G:/Zephyr_Projects/zephyr/boards/st/stm32f4_disco/Kconfig.sysbuild"
```

## at24_eeprom_driver/build/Kconfig/soc/Kconfig
```kconfig
# Load Zephyr SoC Kconfig descriptions.
osource "D:/Zephyr_Projects/external/zephyr/soc/xlnx/zynqmp/Kconfig"
osource "D:/Zephyr_Projects/external/zephyr/soc/xlnx/zynq7000/Kconfig"
osource "D:/Zephyr_Projects/external/zephyr/soc/xlnx/versalnet/Kconfig"
osource "D:/Zephyr_Projects/external/zephyr/soc/xlnx/versal2/Kconfig"
osource "D:/Zephyr_Projects/external/zephyr/soc/xen/Kconfig"
osource "D:/Zephyr_Projects/external/zephyr/soc/wch/ch32v/Kconfig"
osource "D:/Zephyr_Projects/external/zephyr/soc/ti/simplelink/Kconfig"
osource "D:/Zephyr_Projects/external/zephyr/soc/ti/mspm0/Kconfig"
osource "D:/Zephyr_Projects/external/zephyr/soc/ti/lm3s6965/Kconfig"
osource "D:/Zephyr_Projects/external/zephyr/soc/ti/k3/Kconfig"
osource "D:/Zephyr_Projects/external/zephyr/soc/telink/tlsr/Kconfig"
osource "D:/Zephyr_Projects/external/zephyr/soc/starfive/jh71xx/Kconfig"
osource "D:/Zephyr_Projects/external/zephyr/soc/st/stm32/Kconfig"
osource "D:/Zephyr_Projects/external/zephyr/soc/snps/qemu_arc/Kconfig"
osource "D:/Zephyr_Projects/external/zephyr/soc/snps/nsim/arc_v/Kconfig"
osource "D:/Zephyr_Projects/external/zephyr/soc/snps/nsim/arc_classic/Kconfig"
osource "D:/Zephyr_Projects/external/zephyr/soc/snps/hsdk4xd/Kconfig"
osource "D:/Zephyr_Projects/external/zephyr/soc/snps/hsdk/Kconfig"
osource "D:/Zephyr_Projects/external/zephyr/soc/snps/emsk/Kconfig"
osource "D:/Zephyr_Projects/external/zephyr/soc/snps/emsdp/Kconfig"
osource "D:/Zephyr_Projects/external/zephyr/soc/snps/arc_iot/Kconfig"
osource "D:/Zephyr_Projects/external/zephyr/soc/silabs/Kconfig"
osource "D:/Zephyr_Projects/external/zephyr/soc/sifli/sf32/Kconfig"
osource "D:/Zephyr_Projects/external/zephyr/soc/sifive/sifive_freedom/Kconfig"
osource "D:/Zephyr_Projects/external/zephyr/soc/sensry/Kconfig"
osource "D:/Zephyr_Projects/external/zephyr/soc/rockchip/Kconfig"
osource "D:/Zephyr_Projects/external/zephyr/soc/renode/riscv_virtual/Kconfig"
osource "D:/Zephyr_Projects/external/zephyr/soc/renode/cortex_r8_virtual/Kconfig"
osource "D:/Zephyr_Projects/external/zephyr/soc/renesas/smartbond/Kconfig"
osource "D:/Zephyr_Projects/external/zephyr/soc/renesas/rz/Kconfig"
osource "D:/Zephyr_Projects/external/zephyr/soc/renesas/rx/Kconfig"
osource "D:/Zephyr_Projects/external/zephyr/soc/renesas/rcar/Kconfig"
osource "D:/Zephyr_Projects/external/zephyr/soc/renesas/ra/Kconfig"
osource "D:/Zephyr_Projects/external/zephyr/soc/realtek/ec/Kconfig"
osource "D:/Zephyr_Projects/external/zephyr/soc/raspberrypi/rpi_pico/Kconfig"
osource "D:/Zephyr_Projects/external/zephyr/soc/quicklogic/eos_s3/Kconfig"
osource "D:/Zephyr_Projects/external/zephyr/soc/qemu/virt_riscv/Kconfig"
osource "D:/Zephyr_Projects/external/zephyr/soc/qemu/malta/Kconfig"
osource "D:/Zephyr_Projects/external/zephyr/soc/openisa/rv32m1/Kconfig"
osource "D:/Zephyr_Projects/external/zephyr/soc/openhwgroup/cva6/Kconfig"
osource "D:/Zephyr_Projects/external/zephyr/soc/oct/osd32mp15x/Kconfig"
osource "D:/Zephyr_Projects/external/zephyr/soc/nxp/s32/Kconfig"
osource "D:/Zephyr_Projects/external/zephyr/soc/nxp/rw/Kconfig"
osource "D:/Zephyr_Projects/external/zephyr/soc/nxp/mcx/Kconfig"
osource "D:/Zephyr_Projects/external/zephyr/soc/nxp/lpc/Kconfig"
osource "D:/Zephyr_Projects/external/zephyr/soc/nxp/layerscape/Kconfig"
osource "D:/Zephyr_Projects/external/zephyr/soc/nxp/kinetis/Kconfig"
osource "D:/Zephyr_Projects/external/zephyr/soc/nxp/imxrt/Kconfig"
osource "D:/Zephyr_Projects/external/zephyr/soc/nxp/imx/Kconfig"
osource "D:/Zephyr_Projects/external/zephyr/soc/nuvoton/numicro/Kconfig"
osource "D:/Zephyr_Projects/external/zephyr/soc/nuvoton/numaker/Kconfig"
osource "D:/Zephyr_Projects/external/zephyr/soc/nuvoton/npcx/Kconfig"
osource "D:/Zephyr_Projects/external/zephyr/soc/nuvoton/npcm/Kconfig"
osource "D:/Zephyr_Projects/external/zephyr/soc/nordic/Kconfig"
osource "D:/Zephyr_Projects/external/zephyr/soc/neorv32/Kconfig"
osource "D:/Zephyr_Projects/external/zephyr/soc/native/inf_clock/Kconfig"
osource "D:/Zephyr_Projects/external/zephyr/soc/microchip/sam/Kconfig"
osource "D:/Zephyr_Projects/external/zephyr/soc/microchip/sam/sama7/Kconfig"
osource "D:/Zephyr_Projects/external/zephyr/soc/microchip/sam/sam_d5x_e5x/Kconfig"
osource "D:/Zephyr_Projects/external/zephyr/soc/microchip/pic32c/pic32cz_ca/Kconfig"
osource "D:/Zephyr_Projects/external/zephyr/soc/microchip/pic32c/pic32cx_sg/Kconfig"
osource "D:/Zephyr_Projects/external/zephyr/soc/microchip/pic32c/pic32cm_jh/Kconfig"
osource "D:/Zephyr_Projects/external/zephyr/soc/microchip/miv/Kconfig"
osource "D:/Zephyr_Projects/external/zephyr/soc/microchip/mec/Kconfig"
osource "D:/Zephyr_Projects/external/zephyr/soc/mediatek/mt8xxx/Kconfig"
osource "D:/Zephyr_Projects/external/zephyr/soc/lowrisc/opentitan/Kconfig"
osource "D:/Zephyr_Projects/external/zephyr/soc/litex/litex_vexriscv/Kconfig"
osource "D:/Zephyr_Projects/external/zephyr/soc/ite/ec/Kconfig"
osource "D:/Zephyr_Projects/external/zephyr/soc/intel/raptor_lake/Kconfig"
osource "D:/Zephyr_Projects/external/zephyr/soc/intel/panther_lake/Kconfig"
osource "D:/Zephyr_Projects/external/zephyr/soc/intel/lakemont/Kconfig"
osource "D:/Zephyr_Projects/external/zephyr/soc/intel/intel_socfpga_std/Kconfig"
osource "D:/Zephyr_Projects/external/zephyr/soc/intel/intel_socfpga/Kconfig"
osource "D:/Zephyr_Projects/external/zephyr/soc/intel/intel_niosv/Kconfig"
osource "D:/Zephyr_Projects/external/zephyr/soc/intel/intel_ish/Kconfig"
osource "D:/Zephyr_Projects/external/zephyr/soc/intel/intel_adsp/Kconfig"
osource "D:/Zephyr_Projects/external/zephyr/soc/intel/elkhart_lake/Kconfig"
osource "D:/Zephyr_Projects/external/zephyr/soc/intel/atom/Kconfig"
osource "D:/Zephyr_Projects/external/zephyr/soc/intel/apollo_lake/Kconfig"
osource "D:/Zephyr_Projects/external/zephyr/soc/intel/alder_lake/Kconfig"
osource "D:/Zephyr_Projects/external/zephyr/soc/infineon/edge/Kconfig"
osource "D:/Zephyr_Projects/external/zephyr/soc/infineon/cat3/Kconfig"
osource "D:/Zephyr_Projects/external/zephyr/soc/infineon/cat1c/Kconfig"
osource "D:/Zephyr_Projects/external/zephyr/soc/infineon/cat1b/Kconfig"
osource "D:/Zephyr_Projects/external/zephyr/soc/infineon/cat1a/Kconfig"
osource "D:/Zephyr_Projects/external/zephyr/soc/gd/gd32/Kconfig"
osource "D:/Zephyr_Projects/external/zephyr/soc/gaisler/leon3/Kconfig"
osource "D:/Zephyr_Projects/external/zephyr/soc/gaisler/gr716a/Kconfig"
osource "D:/Zephyr_Projects/external/zephyr/soc/espressif/Kconfig"
osource "D:/Zephyr_Projects/external/zephyr/soc/ene/kb1200/Kconfig"
osource "D:/Zephyr_Projects/external/zephyr/soc/ene/kb106x/Kconfig"
osource "D:/Zephyr_Projects/external/zephyr/soc/egis/Kconfig"
osource "D:/Zephyr_Projects/external/zephyr/soc/efinix/sapphire/Kconfig"
osource "D:/Zephyr_Projects/external/zephyr/soc/cdns/xtensa_sample_controller/Kconfig"
osource "D:/Zephyr_Projects/external/zephyr/soc/cdns/sample_controller32/Kconfig"
osource "D:/Zephyr_Projects/external/zephyr/soc/cdns/dc233c/Kconfig"
osource "D:/Zephyr_Projects/external/zephyr/soc/brcm/bcmvk/Kconfig"
osource "D:/Zephyr_Projects/external/zephyr/soc/brcm/bcm2712/Kconfig"
osource "D:/Zephyr_Projects/external/zephyr/soc/brcm/bcm2711/Kconfig"
osource "D:/Zephyr_Projects/external/zephyr/soc/bflb/Kconfig"
osource "D:/Zephyr_Projects/external/zephyr/soc/atmel/sam0/Kconfig"
osource "D:/Zephyr_Projects/external/zephyr/soc/atmel/sam/Kconfig"
osource "D:/Zephyr_Projects/external/zephyr/soc/aspeed/Kconfig"
osource "D:/Zephyr_Projects/external/zephyr/soc/arm/Kconfig"
osource "D:/Zephyr_Projects/external/zephyr/soc/arm/beetle/Kconfig"
osource "D:/Zephyr_Projects/external/zephyr/soc/antmicro/myra/Kconfig"
osource "D:/Zephyr_Projects/external/zephyr/soc/andestech/Kconfig"
osource "D:/Zephyr_Projects/external/zephyr/soc/amd/acp_6_0/Kconfig"
osource "D:/Zephyr_Projects/external/zephyr/soc/ambiq/Kconfig"
osource "D:/Zephyr_Projects/external/zephyr/soc/aesc/Kconfig"
osource "D:/Zephyr_Projects/external/zephyr/soc/adi/max32/Kconfig"
```
