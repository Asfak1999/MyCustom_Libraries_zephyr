## at24_eeprom_driver/build/Kconfig/soc/Kconfig.defconfig.tmp
```kconfig
# Load Zephyr SoC defconfig descriptions.
osource "G:/Zephyr_Projects/zephyr/soc/xlnx/zynqmp/Kconfig.defconfig"
osource "G:/Zephyr_Projects/zephyr/soc/xlnx/zynq7000/Kconfig.defconfig"
osource "G:/Zephyr_Projects/zephyr/soc/xlnx/versalnet/Kconfig.defconfig"
osource "G:/Zephyr_Projects/zephyr/soc/xlnx/versal2/Kconfig.defconfig"
osource "G:/Zephyr_Projects/zephyr/soc/xlnx/versal/Kconfig.defconfig"
osource "G:/Zephyr_Projects/zephyr/soc/xen/Kconfig.defconfig"
osource "G:/Zephyr_Projects/zephyr/soc/wch/ch32v/Kconfig.defconfig"
osource "G:/Zephyr_Projects/zephyr/soc/ti/simplelink/Kconfig.defconfig"
osource "G:/Zephyr_Projects/zephyr/soc/ti/mspm0/Kconfig.defconfig"
osource "G:/Zephyr_Projects/zephyr/soc/ti/lm3s6965/Kconfig.defconfig"
osource "G:/Zephyr_Projects/zephyr/soc/ti/k3/Kconfig.defconfig"
osource "G:/Zephyr_Projects/zephyr/soc/telink/tlsr/Kconfig.defconfig"
osource "G:/Zephyr_Projects/zephyr/soc/starfive/jh71xx/Kconfig.defconfig"
osource "G:/Zephyr_Projects/zephyr/soc/st/stm32/Kconfig.defconfig"
osource "G:/Zephyr_Projects/zephyr/soc/snps/qemu_arc/Kconfig.defconfig"
osource "G:/Zephyr_Projects/zephyr/soc/snps/nsim/arc_v/Kconfig.defconfig"
osource "G:/Zephyr_Projects/zephyr/soc/snps/nsim/arc_classic/Kconfig.defconfig"
osource "G:/Zephyr_Projects/zephyr/soc/snps/hsdk4xd/Kconfig.defconfig"
osource "G:/Zephyr_Projects/zephyr/soc/snps/hsdk/Kconfig.defconfig"
osource "G:/Zephyr_Projects/zephyr/soc/snps/emsk/Kconfig.defconfig"
osource "G:/Zephyr_Projects/zephyr/soc/snps/emsdp/Kconfig.defconfig"
osource "G:/Zephyr_Projects/zephyr/soc/snps/arc_iot/Kconfig.defconfig"
osource "G:/Zephyr_Projects/zephyr/soc/silabs/Kconfig.defconfig"
osource "G:/Zephyr_Projects/zephyr/soc/sifli/sf32/Kconfig.defconfig"
osource "G:/Zephyr_Projects/zephyr/soc/sifive/sifive_freedom/Kconfig.defconfig"
osource "G:/Zephyr_Projects/zephyr/soc/sensry/Kconfig.defconfig"
osource "G:/Zephyr_Projects/zephyr/soc/rockchip/Kconfig.defconfig"
osource "G:/Zephyr_Projects/zephyr/soc/renode/riscv_virtual/Kconfig.defconfig"
osource "G:/Zephyr_Projects/zephyr/soc/renode/cortex_r8_virtual/Kconfig.defconfig"
osource "G:/Zephyr_Projects/zephyr/soc/renesas/smartbond/Kconfig.defconfig"
osource "G:/Zephyr_Projects/zephyr/soc/renesas/rz/Kconfig.defconfig"
osource "G:/Zephyr_Projects/zephyr/soc/renesas/rx/Kconfig.defconfig"
osource "G:/Zephyr_Projects/zephyr/soc/renesas/rcar/Kconfig.defconfig"
osource "G:/Zephyr_Projects/zephyr/soc/renesas/ra/Kconfig.defconfig"
osource "G:/Zephyr_Projects/zephyr/soc/realtek/fingerprint/Kconfig.defconfig"
osource "G:/Zephyr_Projects/zephyr/soc/realtek/ec/Kconfig.defconfig"
osource "G:/Zephyr_Projects/zephyr/soc/realtek/bee/Kconfig.defconfig"
osource "G:/Zephyr_Projects/zephyr/soc/realtek/ameba/Kconfig.defconfig"
osource "G:/Zephyr_Projects/zephyr/soc/raspberrypi/rpi_pico/Kconfig.defconfig"
osource "G:/Zephyr_Projects/zephyr/soc/quicklogic/eos_s3/Kconfig.defconfig"
osource "G:/Zephyr_Projects/zephyr/soc/qemu/virt_riscv/Kconfig.defconfig"
osource "G:/Zephyr_Projects/zephyr/soc/qemu/malta/Kconfig.defconfig"
osource "G:/Zephyr_Projects/zephyr/soc/openisa/rv32m1/Kconfig.defconfig"
osource "G:/Zephyr_Projects/zephyr/soc/openhwgroup/cva6/Kconfig.defconfig"
osource "G:/Zephyr_Projects/zephyr/soc/oct/osd32mp15x/Kconfig.defconfig"
osource "G:/Zephyr_Projects/zephyr/soc/nxp/s32/Kconfig.defconfig"
osource "G:/Zephyr_Projects/zephyr/soc/nxp/rw/Kconfig.defconfig"
osource "G:/Zephyr_Projects/zephyr/soc/nxp/mcx/Kconfig.defconfig"
osource "G:/Zephyr_Projects/zephyr/soc/nxp/lpc/Kconfig.defconfig"
osource "G:/Zephyr_Projects/zephyr/soc/nxp/layerscape/Kconfig.defconfig"
osource "G:/Zephyr_Projects/zephyr/soc/nxp/kinetis/Kconfig.defconfig"
osource "G:/Zephyr_Projects/zephyr/soc/nxp/imxrt/Kconfig.defconfig"
osource "G:/Zephyr_Projects/zephyr/soc/nxp/imx/Kconfig.defconfig"
osource "G:/Zephyr_Projects/zephyr/soc/nuvoton/numicro/Kconfig.defconfig"
osource "G:/Zephyr_Projects/zephyr/soc/nuvoton/numaker/Kconfig.defconfig"
osource "G:/Zephyr_Projects/zephyr/soc/nuvoton/npcx/Kconfig.defconfig"
osource "G:/Zephyr_Projects/zephyr/soc/nuvoton/npcm/Kconfig.defconfig"
osource "G:/Zephyr_Projects/zephyr/soc/nordic/Kconfig.defconfig"
osource "G:/Zephyr_Projects/zephyr/soc/neorv32/Kconfig.defconfig"
osource "G:/Zephyr_Projects/zephyr/soc/native/inf_clock/Kconfig.defconfig"
osource "G:/Zephyr_Projects/zephyr/soc/microchip/sam/sama7/Kconfig.defconfig"
osource "G:/Zephyr_Projects/zephyr/soc/microchip/sam/sam_d5x_e5x/Kconfig.defconfig"
osource "G:/Zephyr_Projects/zephyr/soc/microchip/pic64/Kconfig.defconfig"
osource "G:/Zephyr_Projects/zephyr/soc/microchip/pic32c/pic32cz_ca/Kconfig.defconfig"
osource "G:/Zephyr_Projects/zephyr/soc/microchip/pic32c/pic32cx_sg/Kconfig.defconfig"
osource "G:/Zephyr_Projects/zephyr/soc/microchip/pic32c/pic32cm_pl/Kconfig.defconfig"
osource "G:/Zephyr_Projects/zephyr/soc/microchip/pic32c/pic32cm_jh/Kconfig.defconfig"
osource "G:/Zephyr_Projects/zephyr/soc/microchip/miv/Kconfig.defconfig"
osource "G:/Zephyr_Projects/zephyr/soc/microchip/mec/Kconfig.defconfig"
osource "G:/Zephyr_Projects/zephyr/soc/mediatek/mt8xxx/Kconfig.defconfig"
osource "G:/Zephyr_Projects/zephyr/soc/lowrisc/opentitan/Kconfig.defconfig"
osource "G:/Zephyr_Projects/zephyr/soc/litex/litex_vexriscv/Kconfig.defconfig"
osource "G:/Zephyr_Projects/zephyr/soc/ite/ec/Kconfig.defconfig"
osource "G:/Zephyr_Projects/zephyr/soc/intel/wildcat_lake/Kconfig.defconfig"
osource "G:/Zephyr_Projects/zephyr/soc/intel/raptor_lake/Kconfig.defconfig"
osource "G:/Zephyr_Projects/zephyr/soc/intel/panther_lake/Kconfig.defconfig"
osource "G:/Zephyr_Projects/zephyr/soc/intel/lakemont/Kconfig.defconfig"
osource "G:/Zephyr_Projects/zephyr/soc/intel/intel_socfpga_std/Kconfig.defconfig"
osource "G:/Zephyr_Projects/zephyr/soc/intel/intel_socfpga/Kconfig.defconfig"
osource "G:/Zephyr_Projects/zephyr/soc/intel/intel_niosv/Kconfig.defconfig"
osource "G:/Zephyr_Projects/zephyr/soc/intel/intel_ish/Kconfig.defconfig"
osource "G:/Zephyr_Projects/zephyr/soc/intel/intel_adsp/Kconfig.defconfig"
osource "G:/Zephyr_Projects/zephyr/soc/intel/elkhart_lake/Kconfig.defconfig"
osource "G:/Zephyr_Projects/zephyr/soc/intel/atom/Kconfig.defconfig"
osource "G:/Zephyr_Projects/zephyr/soc/intel/apollo_lake/Kconfig.defconfig"
osource "G:/Zephyr_Projects/zephyr/soc/intel/alder_lake/Kconfig.defconfig"
osource "G:/Zephyr_Projects/zephyr/soc/infineon/psoc4/Kconfig.defconfig"
osource "G:/Zephyr_Projects/zephyr/soc/infineon/edge/Kconfig.defconfig"
osource "G:/Zephyr_Projects/zephyr/soc/infineon/cat3/Kconfig.defconfig"
osource "G:/Zephyr_Projects/zephyr/soc/infineon/cat1c/Kconfig.defconfig"
osource "G:/Zephyr_Projects/zephyr/soc/infineon/cat1b/Kconfig.defconfig"
osource "G:/Zephyr_Projects/zephyr/soc/infineon/cat1a/Kconfig.defconfig"
osource "G:/Zephyr_Projects/zephyr/soc/gd/gd32/Kconfig.defconfig"
osource "G:/Zephyr_Projects/zephyr/soc/gaisler/leon3/Kconfig.defconfig"
osource "G:/Zephyr_Projects/zephyr/soc/gaisler/gr716a/Kconfig.defconfig"
osource "G:/Zephyr_Projects/zephyr/soc/focaltech/Kconfig.defconfig"
osource "G:/Zephyr_Projects/zephyr/soc/espressif/Kconfig.defconfig"
osource "G:/Zephyr_Projects/zephyr/soc/ene/kb1200/Kconfig.defconfig"
osource "G:/Zephyr_Projects/zephyr/soc/ene/kb106x/Kconfig.defconfig"
osource "G:/Zephyr_Projects/zephyr/soc/elan/em32f967/Kconfig.defconfig"
osource "G:/Zephyr_Projects/zephyr/soc/egis/Kconfig.defconfig"
osource "G:/Zephyr_Projects/zephyr/soc/efinix/sapphire/Kconfig.defconfig"
osource "G:/Zephyr_Projects/zephyr/soc/cdns/xtensa_sample_controller/Kconfig.defconfig"
osource "G:/Zephyr_Projects/zephyr/soc/cdns/sample_controller32/Kconfig.defconfig"
osource "G:/Zephyr_Projects/zephyr/soc/cdns/dc233c/Kconfig.defconfig"
osource "G:/Zephyr_Projects/zephyr/soc/brcm/bcmvk/Kconfig.defconfig"
osource "G:/Zephyr_Projects/zephyr/soc/brcm/bcm2712/Kconfig.defconfig"
osource "G:/Zephyr_Projects/zephyr/soc/brcm/bcm2711/Kconfig.defconfig"
osource "G:/Zephyr_Projects/zephyr/soc/blackberry/qnxhv_vm/Kconfig.defconfig"
osource "G:/Zephyr_Projects/zephyr/soc/bflb/Kconfig.defconfig"
osource "G:/Zephyr_Projects/zephyr/soc/atmel/sam0/Kconfig.defconfig"
osource "G:/Zephyr_Projects/zephyr/soc/atmel/sam/Kconfig.defconfig"
osource "G:/Zephyr_Projects/zephyr/soc/aspeed/Kconfig.defconfig"
osource "G:/Zephyr_Projects/zephyr/soc/arm/Kconfig.defconfig"
osource "G:/Zephyr_Projects/zephyr/soc/arm/beetle/Kconfig.defconfig"
osource "G:/Zephyr_Projects/zephyr/soc/antmicro/myra/Kconfig.defconfig"
osource "G:/Zephyr_Projects/zephyr/soc/andestech/Kconfig.defconfig"
osource "G:/Zephyr_Projects/zephyr/soc/amd/acp_6_0/Kconfig.defconfig"
osource "G:/Zephyr_Projects/zephyr/soc/ambiq/Kconfig.defconfig"
osource "G:/Zephyr_Projects/zephyr/soc/allwinner/sun8i_h3/Kconfig.defconfig"
osource "G:/Zephyr_Projects/zephyr/soc/alif/ensemble/Kconfig.defconfig"
osource "G:/Zephyr_Projects/zephyr/soc/aesc/Kconfig.defconfig"
osource "G:/Zephyr_Projects/zephyr/soc/adi/max32/Kconfig.defconfig"
```
