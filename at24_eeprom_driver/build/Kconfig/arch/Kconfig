## at24_eeprom_driver/build/Kconfig/soc/Kconfig.sysbuild
```kconfig
# Load Sysbuild SoC Kconfig descriptions.
osource "D:/Zephyr_Projects/external/zephyr/soc/xlnx/zynqmp/Kconfig.sysbuild"
osource "D:/Zephyr_Projects/external/zephyr/soc/xlnx/zynq7000/Kconfig.sysbuild"
osource "D:/Zephyr_Projects/external/zephyr/soc/xlnx/versalnet/Kconfig.sysbuild"
osource "D:/Zephyr_Projects/external/zephyr/soc/xlnx/versal2/Kconfig.sysbuild"
osource "D:/Zephyr_Projects/external/zephyr/soc/xen/Kconfig.sysbuild"
osource "D:/Zephyr_Projects/external/zephyr/soc/wch/ch32v/Kconfig.sysbuild"
osource "D:/Zephyr_Projects/external/zephyr/soc/ti/simplelink/Kconfig.sysbuild"
osource "D:/Zephyr_Projects/external/zephyr/soc/ti/mspm0/Kconfig.sysbuild"
osource "D:/Zephyr_Projects/external/zephyr/soc/ti/lm3s6965/Kconfig.sysbuild"
osource "D:/Zephyr_Projects/external/zephyr/soc/ti/k3/Kconfig.sysbuild"
osource "D:/Zephyr_Projects/external/zephyr/soc/telink/tlsr/Kconfig.sysbuild"
osource "D:/Zephyr_Projects/external/zephyr/soc/starfive/jh71xx/Kconfig.sysbuild"
osource "D:/Zephyr_Projects/external/zephyr/soc/st/stm32/Kconfig.sysbuild"
osource "D:/Zephyr_Projects/external/zephyr/soc/snps/qemu_arc/Kconfig.sysbuild"
osource "D:/Zephyr_Projects/external/zephyr/soc/snps/nsim/arc_v/Kconfig.sysbuild"
osource "D:/Zephyr_Projects/external/zephyr/soc/snps/nsim/arc_classic/Kconfig.sysbuild"
osource "D:/Zephyr_Projects/external/zephyr/soc/snps/hsdk4xd/Kconfig.sysbuild"
osource "D:/Zephyr_Projects/external/zephyr/soc/snps/hsdk/Kconfig.sysbuild"
osource "D:/Zephyr_Projects/external/zephyr/soc/snps/emsk/Kconfig.sysbuild"
osource "D:/Zephyr_Projects/external/zephyr/soc/snps/emsdp/Kconfig.sysbuild"
osource "D:/Zephyr_Projects/external/zephyr/soc/snps/arc_iot/Kconfig.sysbuild"
osource "D:/Zephyr_Projects/external/zephyr/soc/silabs/Kconfig.sysbuild"
osource "D:/Zephyr_Projects/external/zephyr/soc/sifli/sf32/Kconfig.sysbuild"
osource "D:/Zephyr_Projects/external/zephyr/soc/sifive/sifive_freedom/Kconfig.sysbuild"
osource "D:/Zephyr_Projects/external/zephyr/soc/sensry/Kconfig.sysbuild"
osource "D:/Zephyr_Projects/external/zephyr/soc/rockchip/Kconfig.sysbuild"
osource "D:/Zephyr_Projects/external/zephyr/soc/renode/riscv_virtual/Kconfig.sysbuild"
osource "D:/Zephyr_Projects/external/zephyr/soc/renode/cortex_r8_virtual/Kconfig.sysbuild"
osource "D:/Zephyr_Projects/external/zephyr/soc/renesas/smartbond/Kconfig.sysbuild"
osource "D:/Zephyr_Projects/external/zephyr/soc/renesas/rz/Kconfig.sysbuild"
osource "D:/Zephyr_Projects/external/zephyr/soc/renesas/rx/Kconfig.sysbuild"
osource "D:/Zephyr_Projects/external/zephyr/soc/renesas/rcar/Kconfig.sysbuild"
osource "D:/Zephyr_Projects/external/zephyr/soc/renesas/ra/Kconfig.sysbuild"
osource "D:/Zephyr_Projects/external/zephyr/soc/realtek/ec/Kconfig.sysbuild"
osource "D:/Zephyr_Projects/external/zephyr/soc/raspberrypi/rpi_pico/Kconfig.sysbuild"
osource "D:/Zephyr_Projects/external/zephyr/soc/quicklogic/eos_s3/Kconfig.sysbuild"
osource "D:/Zephyr_Projects/external/zephyr/soc/qemu/virt_riscv/Kconfig.sysbuild"
osource "D:/Zephyr_Projects/external/zephyr/soc/qemu/malta/Kconfig.sysbuild"
osource "D:/Zephyr_Projects/external/zephyr/soc/openisa/rv32m1/Kconfig.sysbuild"
osource "D:/Zephyr_Projects/external/zephyr/soc/openhwgroup/cva6/Kconfig.sysbuild"
osource "D:/Zephyr_Projects/external/zephyr/soc/oct/osd32mp15x/Kconfig.sysbuild"
osource "D:/Zephyr_Projects/external/zephyr/soc/nxp/s32/Kconfig.sysbuild"
osource "D:/Zephyr_Projects/external/zephyr/soc/nxp/rw/Kconfig.sysbuild"
osource "D:/Zephyr_Projects/external/zephyr/soc/nxp/mcx/Kconfig.sysbuild"
osource "D:/Zephyr_Projects/external/zephyr/soc/nxp/lpc/Kconfig.sysbuild"
osource "D:/Zephyr_Projects/external/zephyr/soc/nxp/layerscape/Kconfig.sysbuild"
osource "D:/Zephyr_Projects/external/zephyr/soc/nxp/kinetis/Kconfig.sysbuild"
osource "D:/Zephyr_Projects/external/zephyr/soc/nxp/imxrt/Kconfig.sysbuild"
osource "D:/Zephyr_Projects/external/zephyr/soc/nxp/imx/Kconfig.sysbuild"
osource "D:/Zephyr_Projects/external/zephyr/soc/nuvoton/numicro/Kconfig.sysbuild"
osource "D:/Zephyr_Projects/external/zephyr/soc/nuvoton/numaker/Kconfig.sysbuild"
osource "D:/Zephyr_Projects/external/zephyr/soc/nuvoton/npcx/Kconfig.sysbuild"
osource "D:/Zephyr_Projects/external/zephyr/soc/nuvoton/npcm/Kconfig.sysbuild"
osource "D:/Zephyr_Projects/external/zephyr/soc/nordic/Kconfig.sysbuild"
osource "D:/Zephyr_Projects/external/zephyr/soc/neorv32/Kconfig.sysbuild"
osource "D:/Zephyr_Projects/external/zephyr/soc/native/inf_clock/Kconfig.sysbuild"
osource "D:/Zephyr_Projects/external/zephyr/soc/microchip/sam/Kconfig.sysbuild"
osource "D:/Zephyr_Projects/external/zephyr/soc/microchip/sam/sama7/Kconfig.sysbuild"
osource "D:/Zephyr_Projects/external/zephyr/soc/microchip/sam/sam_d5x_e5x/Kconfig.sysbuild"
osource "D:/Zephyr_Projects/external/zephyr/soc/microchip/pic32c/pic32cz_ca/Kconfig.sysbuild"
osource "D:/Zephyr_Projects/external/zephyr/soc/microchip/pic32c/pic32cx_sg/Kconfig.sysbuild"
osource "D:/Zephyr_Projects/external/zephyr/soc/microchip/pic32c/pic32cm_jh/Kconfig.sysbuild"
osource "D:/Zephyr_Projects/external/zephyr/soc/microchip/miv/Kconfig.sysbuild"
osource "D:/Zephyr_Projects/external/zephyr/soc/microchip/mec/Kconfig.sysbuild"
osource "D:/Zephyr_Projects/external/zephyr/soc/mediatek/mt8xxx/Kconfig.sysbuild"
osource "D:/Zephyr_Projects/external/zephyr/soc/lowrisc/opentitan/Kconfig.sysbuild"
osource "D:/Zephyr_Projects/external/zephyr/soc/litex/litex_vexriscv/Kconfig.sysbuild"
osource "D:/Zephyr_Projects/external/zephyr/soc/ite/ec/Kconfig.sysbuild"
osource "D:/Zephyr_Projects/external/zephyr/soc/intel/raptor_lake/Kconfig.sysbuild"
osource "D:/Zephyr_Projects/external/zephyr/soc/intel/panther_lake/Kconfig.sysbuild"
osource "D:/Zephyr_Projects/external/zephyr/soc/intel/lakemont/Kconfig.sysbuild"
osource "D:/Zephyr_Projects/external/zephyr/soc/intel/intel_socfpga_std/Kconfig.sysbuild"
osource "D:/Zephyr_Projects/external/zephyr/soc/intel/intel_socfpga/Kconfig.sysbuild"
osource "D:/Zephyr_Projects/external/zephyr/soc/intel/intel_niosv/Kconfig.sysbuild"
osource "D:/Zephyr_Projects/external/zephyr/soc/intel/intel_ish/Kconfig.sysbuild"
osource "D:/Zephyr_Projects/external/zephyr/soc/intel/intel_adsp/Kconfig.sysbuild"
osource "D:/Zephyr_Projects/external/zephyr/soc/intel/elkhart_lake/Kconfig.sysbuild"
osource "D:/Zephyr_Projects/external/zephyr/soc/intel/atom/Kconfig.sysbuild"
osource "D:/Zephyr_Projects/external/zephyr/soc/intel/apollo_lake/Kconfig.sysbuild"
osource "D:/Zephyr_Projects/external/zephyr/soc/intel/alder_lake/Kconfig.sysbuild"
osource "D:/Zephyr_Projects/external/zephyr/soc/infineon/edge/Kconfig.sysbuild"
osource "D:/Zephyr_Projects/external/zephyr/soc/infineon/cat3/Kconfig.sysbuild"
osource "D:/Zephyr_Projects/external/zephyr/soc/infineon/cat1c/Kconfig.sysbuild"
osource "D:/Zephyr_Projects/external/zephyr/soc/infineon/cat1b/Kconfig.sysbuild"
osource "D:/Zephyr_Projects/external/zephyr/soc/infineon/cat1a/Kconfig.sysbuild"
osource "D:/Zephyr_Projects/external/zephyr/soc/gd/gd32/Kconfig.sysbuild"
osource "D:/Zephyr_Projects/external/zephyr/soc/gaisler/leon3/Kconfig.sysbuild"
osource "D:/Zephyr_Projects/external/zephyr/soc/gaisler/gr716a/Kconfig.sysbuild"
osource "D:/Zephyr_Projects/external/zephyr/soc/espressif/Kconfig.sysbuild"
osource "D:/Zephyr_Projects/external/zephyr/soc/ene/kb1200/Kconfig.sysbuild"
osource "D:/Zephyr_Projects/external/zephyr/soc/ene/kb106x/Kconfig.sysbuild"
osource "D:/Zephyr_Projects/external/zephyr/soc/egis/Kconfig.sysbuild"
osource "D:/Zephyr_Projects/external/zephyr/soc/efinix/sapphire/Kconfig.sysbuild"
osource "D:/Zephyr_Projects/external/zephyr/soc/cdns/xtensa_sample_controller/Kconfig.sysbuild"
osource "D:/Zephyr_Projects/external/zephyr/soc/cdns/sample_controller32/Kconfig.sysbuild"
osource "D:/Zephyr_Projects/external/zephyr/soc/cdns/dc233c/Kconfig.sysbuild"
osource "D:/Zephyr_Projects/external/zephyr/soc/brcm/bcmvk/Kconfig.sysbuild"
osource "D:/Zephyr_Projects/external/zephyr/soc/brcm/bcm2712/Kconfig.sysbuild"
osource "D:/Zephyr_Projects/external/zephyr/soc/brcm/bcm2711/Kconfig.sysbuild"
osource "D:/Zephyr_Projects/external/zephyr/soc/bflb/Kconfig.sysbuild"
osource "D:/Zephyr_Projects/external/zephyr/soc/atmel/sam0/Kconfig.sysbuild"
osource "D:/Zephyr_Projects/external/zephyr/soc/atmel/sam/Kconfig.sysbuild"
osource "D:/Zephyr_Projects/external/zephyr/soc/aspeed/Kconfig.sysbuild"
osource "D:/Zephyr_Projects/external/zephyr/soc/arm/Kconfig.sysbuild"
osource "D:/Zephyr_Projects/external/zephyr/soc/arm/beetle/Kconfig.sysbuild"
osource "D:/Zephyr_Projects/external/zephyr/soc/antmicro/myra/Kconfig.sysbuild"
osource "D:/Zephyr_Projects/external/zephyr/soc/andestech/Kconfig.sysbuild"
osource "D:/Zephyr_Projects/external/zephyr/soc/amd/acp_6_0/Kconfig.sysbuild"
osource "D:/Zephyr_Projects/external/zephyr/soc/ambiq/Kconfig.sysbuild"
osource "D:/Zephyr_Projects/external/zephyr/soc/aesc/Kconfig.sysbuild"
osource "D:/Zephyr_Projects/external/zephyr/soc/adi/max32/Kconfig.sysbuild"
```
