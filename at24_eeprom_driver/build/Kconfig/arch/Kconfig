## at24_eeprom_driver/build/Kconfig/soc/Kconfig.tmp
```kconfig
# Load Zephyr SoC Kconfig descriptions.
osource "G:/Zephyr_Projects/zephyr/soc/xlnx/zynqmp/Kconfig"
osource "G:/Zephyr_Projects/zephyr/soc/xlnx/zynq7000/Kconfig"
osource "G:/Zephyr_Projects/zephyr/soc/xlnx/versalnet/Kconfig"
osource "G:/Zephyr_Projects/zephyr/soc/xlnx/versal2/Kconfig"
osource "G:/Zephyr_Projects/zephyr/soc/xlnx/versal/Kconfig"
osource "G:/Zephyr_Projects/zephyr/soc/xen/Kconfig"
osource "G:/Zephyr_Projects/zephyr/soc/wch/ch32v/Kconfig"
osource "G:/Zephyr_Projects/zephyr/soc/ti/simplelink/Kconfig"
osource "G:/Zephyr_Projects/zephyr/soc/ti/mspm0/Kconfig"
osource "G:/Zephyr_Projects/zephyr/soc/ti/lm3s6965/Kconfig"
osource "G:/Zephyr_Projects/zephyr/soc/ti/k3/Kconfig"
osource "G:/Zephyr_Projects/zephyr/soc/telink/tlsr/Kconfig"
osource "G:/Zephyr_Projects/zephyr/soc/starfive/jh71xx/Kconfig"
osource "G:/Zephyr_Projects/zephyr/soc/st/stm32/Kconfig"
osource "G:/Zephyr_Projects/zephyr/soc/snps/qemu_arc/Kconfig"
osource "G:/Zephyr_Projects/zephyr/soc/snps/nsim/arc_v/Kconfig"
osource "G:/Zephyr_Projects/zephyr/soc/snps/nsim/arc_classic/Kconfig"
osource "G:/Zephyr_Projects/zephyr/soc/snps/hsdk4xd/Kconfig"
osource "G:/Zephyr_Projects/zephyr/soc/snps/hsdk/Kconfig"
osource "G:/Zephyr_Projects/zephyr/soc/snps/emsk/Kconfig"
osource "G:/Zephyr_Projects/zephyr/soc/snps/emsdp/Kconfig"
osource "G:/Zephyr_Projects/zephyr/soc/snps/arc_iot/Kconfig"
osource "G:/Zephyr_Projects/zephyr/soc/silabs/Kconfig"
osource "G:/Zephyr_Projects/zephyr/soc/sifli/sf32/Kconfig"
osource "G:/Zephyr_Projects/zephyr/soc/sifive/sifive_freedom/Kconfig"
osource "G:/Zephyr_Projects/zephyr/soc/sensry/Kconfig"
osource "G:/Zephyr_Projects/zephyr/soc/rockchip/Kconfig"
osource "G:/Zephyr_Projects/zephyr/soc/renode/riscv_virtual/Kconfig"
osource "G:/Zephyr_Projects/zephyr/soc/renode/cortex_r8_virtual/Kconfig"
osource "G:/Zephyr_Projects/zephyr/soc/renesas/smartbond/Kconfig"
osource "G:/Zephyr_Projects/zephyr/soc/renesas/rz/Kconfig"
osource "G:/Zephyr_Projects/zephyr/soc/renesas/rx/Kconfig"
osource "G:/Zephyr_Projects/zephyr/soc/renesas/rcar/Kconfig"
osource "G:/Zephyr_Projects/zephyr/soc/renesas/ra/Kconfig"
osource "G:/Zephyr_Projects/zephyr/soc/realtek/fingerprint/Kconfig"
osource "G:/Zephyr_Projects/zephyr/soc/realtek/ec/Kconfig"
osource "G:/Zephyr_Projects/zephyr/soc/realtek/bee/Kconfig"
osource "G:/Zephyr_Projects/zephyr/soc/realtek/ameba/Kconfig"
osource "G:/Zephyr_Projects/zephyr/soc/raspberrypi/rpi_pico/Kconfig"
osource "G:/Zephyr_Projects/zephyr/soc/quicklogic/eos_s3/Kconfig"
osource "G:/Zephyr_Projects/zephyr/soc/qemu/virt_riscv/Kconfig"
osource "G:/Zephyr_Projects/zephyr/soc/qemu/malta/Kconfig"
osource "G:/Zephyr_Projects/zephyr/soc/openisa/rv32m1/Kconfig"
osource "G:/Zephyr_Projects/zephyr/soc/openhwgroup/cva6/Kconfig"
osource "G:/Zephyr_Projects/zephyr/soc/oct/osd32mp15x/Kconfig"
osource "G:/Zephyr_Projects/zephyr/soc/nxp/s32/Kconfig"
osource "G:/Zephyr_Projects/zephyr/soc/nxp/rw/Kconfig"
osource "G:/Zephyr_Projects/zephyr/soc/nxp/mcx/Kconfig"
osource "G:/Zephyr_Projects/zephyr/soc/nxp/lpc/Kconfig"
osource "G:/Zephyr_Projects/zephyr/soc/nxp/layerscape/Kconfig"
osource "G:/Zephyr_Projects/zephyr/soc/nxp/kinetis/Kconfig"
osource "G:/Zephyr_Projects/zephyr/soc/nxp/imxrt/Kconfig"
osource "G:/Zephyr_Projects/zephyr/soc/nxp/imx/Kconfig"
osource "G:/Zephyr_Projects/zephyr/soc/nuvoton/numicro/Kconfig"
osource "G:/Zephyr_Projects/zephyr/soc/nuvoton/numaker/Kconfig"
osource "G:/Zephyr_Projects/zephyr/soc/nuvoton/npcx/Kconfig"
osource "G:/Zephyr_Projects/zephyr/soc/nuvoton/npcm/Kconfig"
osource "G:/Zephyr_Projects/zephyr/soc/nordic/Kconfig"
osource "G:/Zephyr_Projects/zephyr/soc/neorv32/Kconfig"
osource "G:/Zephyr_Projects/zephyr/soc/native/inf_clock/Kconfig"
osource "G:/Zephyr_Projects/zephyr/soc/microchip/sam/sama7/Kconfig"
osource "G:/Zephyr_Projects/zephyr/soc/microchip/sam/sam_d5x_e5x/Kconfig"
osource "G:/Zephyr_Projects/zephyr/soc/microchip/pic64/Kconfig"
osource "G:/Zephyr_Projects/zephyr/soc/microchip/pic32c/pic32cz_ca/Kconfig"
osource "G:/Zephyr_Projects/zephyr/soc/microchip/pic32c/pic32cx_sg/Kconfig"
osource "G:/Zephyr_Projects/zephyr/soc/microchip/pic32c/pic32cm_pl/Kconfig"
osource "G:/Zephyr_Projects/zephyr/soc/microchip/pic32c/pic32cm_jh/Kconfig"
osource "G:/Zephyr_Projects/zephyr/soc/microchip/miv/Kconfig"
osource "G:/Zephyr_Projects/zephyr/soc/microchip/mec/Kconfig"
osource "G:/Zephyr_Projects/zephyr/soc/mediatek/mt8xxx/Kconfig"
osource "G:/Zephyr_Projects/zephyr/soc/lowrisc/opentitan/Kconfig"
osource "G:/Zephyr_Projects/zephyr/soc/litex/litex_vexriscv/Kconfig"
osource "G:/Zephyr_Projects/zephyr/soc/ite/ec/Kconfig"
osource "G:/Zephyr_Projects/zephyr/soc/intel/wildcat_lake/Kconfig"
osource "G:/Zephyr_Projects/zephyr/soc/intel/raptor_lake/Kconfig"
osource "G:/Zephyr_Projects/zephyr/soc/intel/panther_lake/Kconfig"
osource "G:/Zephyr_Projects/zephyr/soc/intel/lakemont/Kconfig"
osource "G:/Zephyr_Projects/zephyr/soc/intel/intel_socfpga_std/Kconfig"
osource "G:/Zephyr_Projects/zephyr/soc/intel/intel_socfpga/Kconfig"
osource "G:/Zephyr_Projects/zephyr/soc/intel/intel_niosv/Kconfig"
osource "G:/Zephyr_Projects/zephyr/soc/intel/intel_ish/Kconfig"
osource "G:/Zephyr_Projects/zephyr/soc/intel/intel_adsp/Kconfig"
osource "G:/Zephyr_Projects/zephyr/soc/intel/elkhart_lake/Kconfig"
osource "G:/Zephyr_Projects/zephyr/soc/intel/atom/Kconfig"
osource "G:/Zephyr_Projects/zephyr/soc/intel/apollo_lake/Kconfig"
osource "G:/Zephyr_Projects/zephyr/soc/intel/alder_lake/Kconfig"
osource "G:/Zephyr_Projects/zephyr/soc/infineon/psoc4/Kconfig"
osource "G:/Zephyr_Projects/zephyr/soc/infineon/edge/Kconfig"
osource "G:/Zephyr_Projects/zephyr/soc/infineon/cat3/Kconfig"
osource "G:/Zephyr_Projects/zephyr/soc/infineon/cat1c/Kconfig"
osource "G:/Zephyr_Projects/zephyr/soc/infineon/cat1b/Kconfig"
osource "G:/Zephyr_Projects/zephyr/soc/infineon/cat1a/Kconfig"
osource "G:/Zephyr_Projects/zephyr/soc/gd/gd32/Kconfig"
osource "G:/Zephyr_Projects/zephyr/soc/gaisler/leon3/Kconfig"
osource "G:/Zephyr_Projects/zephyr/soc/gaisler/gr716a/Kconfig"
osource "G:/Zephyr_Projects/zephyr/soc/focaltech/Kconfig"
osource "G:/Zephyr_Projects/zephyr/soc/espressif/Kconfig"
osource "G:/Zephyr_Projects/zephyr/soc/ene/kb1200/Kconfig"
osource "G:/Zephyr_Projects/zephyr/soc/ene/kb106x/Kconfig"
osource "G:/Zephyr_Projects/zephyr/soc/elan/em32f967/Kconfig"
osource "G:/Zephyr_Projects/zephyr/soc/egis/Kconfig"
osource "G:/Zephyr_Projects/zephyr/soc/efinix/sapphire/Kconfig"
osource "G:/Zephyr_Projects/zephyr/soc/cdns/xtensa_sample_controller/Kconfig"
osource "G:/Zephyr_Projects/zephyr/soc/cdns/sample_controller32/Kconfig"
osource "G:/Zephyr_Projects/zephyr/soc/cdns/dc233c/Kconfig"
osource "G:/Zephyr_Projects/zephyr/soc/brcm/bcmvk/Kconfig"
osource "G:/Zephyr_Projects/zephyr/soc/brcm/bcm2712/Kconfig"
osource "G:/Zephyr_Projects/zephyr/soc/brcm/bcm2711/Kconfig"
osource "G:/Zephyr_Projects/zephyr/soc/blackberry/qnxhv_vm/Kconfig"
osource "G:/Zephyr_Projects/zephyr/soc/bflb/Kconfig"
osource "G:/Zephyr_Projects/zephyr/soc/atmel/sam0/Kconfig"
osource "G:/Zephyr_Projects/zephyr/soc/atmel/sam/Kconfig"
osource "G:/Zephyr_Projects/zephyr/soc/aspeed/Kconfig"
osource "G:/Zephyr_Projects/zephyr/soc/arm/Kconfig"
osource "G:/Zephyr_Projects/zephyr/soc/arm/beetle/Kconfig"
osource "G:/Zephyr_Projects/zephyr/soc/antmicro/myra/Kconfig"
osource "G:/Zephyr_Projects/zephyr/soc/andestech/Kconfig"
osource "G:/Zephyr_Projects/zephyr/soc/amd/acp_6_0/Kconfig"
osource "G:/Zephyr_Projects/zephyr/soc/ambiq/Kconfig"
osource "G:/Zephyr_Projects/zephyr/soc/allwinner/sun8i_h3/Kconfig"
osource "G:/Zephyr_Projects/zephyr/soc/alif/ensemble/Kconfig"
osource "G:/Zephyr_Projects/zephyr/soc/aesc/Kconfig"
osource "G:/Zephyr_Projects/zephyr/soc/adi/max32/Kconfig"
```
