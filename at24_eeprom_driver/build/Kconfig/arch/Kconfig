## at24_eeprom_driver/build/Kconfig/soc/Kconfig.sysbuild.tmp
```kconfig
# Load Sysbuild SoC Kconfig descriptions.
osource "G:/Zephyr_Projects/zephyr/soc/xlnx/zynqmp/Kconfig.sysbuild"
osource "G:/Zephyr_Projects/zephyr/soc/xlnx/zynq7000/Kconfig.sysbuild"
osource "G:/Zephyr_Projects/zephyr/soc/xlnx/versalnet/Kconfig.sysbuild"
osource "G:/Zephyr_Projects/zephyr/soc/xlnx/versal2/Kconfig.sysbuild"
osource "G:/Zephyr_Projects/zephyr/soc/xlnx/versal/Kconfig.sysbuild"
osource "G:/Zephyr_Projects/zephyr/soc/xen/Kconfig.sysbuild"
osource "G:/Zephyr_Projects/zephyr/soc/wch/ch32v/Kconfig.sysbuild"
osource "G:/Zephyr_Projects/zephyr/soc/ti/simplelink/Kconfig.sysbuild"
osource "G:/Zephyr_Projects/zephyr/soc/ti/mspm0/Kconfig.sysbuild"
osource "G:/Zephyr_Projects/zephyr/soc/ti/lm3s6965/Kconfig.sysbuild"
osource "G:/Zephyr_Projects/zephyr/soc/ti/k3/Kconfig.sysbuild"
osource "G:/Zephyr_Projects/zephyr/soc/telink/tlsr/Kconfig.sysbuild"
osource "G:/Zephyr_Projects/zephyr/soc/starfive/jh71xx/Kconfig.sysbuild"
osource "G:/Zephyr_Projects/zephyr/soc/st/stm32/Kconfig.sysbuild"
osource "G:/Zephyr_Projects/zephyr/soc/snps/qemu_arc/Kconfig.sysbuild"
osource "G:/Zephyr_Projects/zephyr/soc/snps/nsim/arc_v/Kconfig.sysbuild"
osource "G:/Zephyr_Projects/zephyr/soc/snps/nsim/arc_classic/Kconfig.sysbuild"
osource "G:/Zephyr_Projects/zephyr/soc/snps/hsdk4xd/Kconfig.sysbuild"
osource "G:/Zephyr_Projects/zephyr/soc/snps/hsdk/Kconfig.sysbuild"
osource "G:/Zephyr_Projects/zephyr/soc/snps/emsk/Kconfig.sysbuild"
osource "G:/Zephyr_Projects/zephyr/soc/snps/emsdp/Kconfig.sysbuild"
osource "G:/Zephyr_Projects/zephyr/soc/snps/arc_iot/Kconfig.sysbuild"
osource "G:/Zephyr_Projects/zephyr/soc/silabs/Kconfig.sysbuild"
osource "G:/Zephyr_Projects/zephyr/soc/sifli/sf32/Kconfig.sysbuild"
osource "G:/Zephyr_Projects/zephyr/soc/sifive/sifive_freedom/Kconfig.sysbuild"
osource "G:/Zephyr_Projects/zephyr/soc/sensry/Kconfig.sysbuild"
osource "G:/Zephyr_Projects/zephyr/soc/rockchip/Kconfig.sysbuild"
osource "G:/Zephyr_Projects/zephyr/soc/renode/riscv_virtual/Kconfig.sysbuild"
osource "G:/Zephyr_Projects/zephyr/soc/renode/cortex_r8_virtual/Kconfig.sysbuild"
osource "G:/Zephyr_Projects/zephyr/soc/renesas/smartbond/Kconfig.sysbuild"
osource "G:/Zephyr_Projects/zephyr/soc/renesas/rz/Kconfig.sysbuild"
osource "G:/Zephyr_Projects/zephyr/soc/renesas/rx/Kconfig.sysbuild"
osource "G:/Zephyr_Projects/zephyr/soc/renesas/rcar/Kconfig.sysbuild"
osource "G:/Zephyr_Projects/zephyr/soc/renesas/ra/Kconfig.sysbuild"
osource "G:/Zephyr_Projects/zephyr/soc/realtek/fingerprint/Kconfig.sysbuild"
osource "G:/Zephyr_Projects/zephyr/soc/realtek/ec/Kconfig.sysbuild"
osource "G:/Zephyr_Projects/zephyr/soc/realtek/bee/Kconfig.sysbuild"
osource "G:/Zephyr_Projects/zephyr/soc/realtek/ameba/Kconfig.sysbuild"
osource "G:/Zephyr_Projects/zephyr/soc/raspberrypi/rpi_pico/Kconfig.sysbuild"
osource "G:/Zephyr_Projects/zephyr/soc/quicklogic/eos_s3/Kconfig.sysbuild"
osource "G:/Zephyr_Projects/zephyr/soc/qemu/virt_riscv/Kconfig.sysbuild"
osource "G:/Zephyr_Projects/zephyr/soc/qemu/malta/Kconfig.sysbuild"
osource "G:/Zephyr_Projects/zephyr/soc/openisa/rv32m1/Kconfig.sysbuild"
osource "G:/Zephyr_Projects/zephyr/soc/openhwgroup/cva6/Kconfig.sysbuild"
osource "G:/Zephyr_Projects/zephyr/soc/oct/osd32mp15x/Kconfig.sysbuild"
osource "G:/Zephyr_Projects/zephyr/soc/nxp/s32/Kconfig.sysbuild"
osource "G:/Zephyr_Projects/zephyr/soc/nxp/rw/Kconfig.sysbuild"
osource "G:/Zephyr_Projects/zephyr/soc/nxp/mcx/Kconfig.sysbuild"
osource "G:/Zephyr_Projects/zephyr/soc/nxp/lpc/Kconfig.sysbuild"
osource "G:/Zephyr_Projects/zephyr/soc/nxp/layerscape/Kconfig.sysbuild"
osource "G:/Zephyr_Projects/zephyr/soc/nxp/kinetis/Kconfig.sysbuild"
osource "G:/Zephyr_Projects/zephyr/soc/nxp/imxrt/Kconfig.sysbuild"
osource "G:/Zephyr_Projects/zephyr/soc/nxp/imx/Kconfig.sysbuild"
osource "G:/Zephyr_Projects/zephyr/soc/nuvoton/numicro/Kconfig.sysbuild"
osource "G:/Zephyr_Projects/zephyr/soc/nuvoton/numaker/Kconfig.sysbuild"
osource "G:/Zephyr_Projects/zephyr/soc/nuvoton/npcx/Kconfig.sysbuild"
osource "G:/Zephyr_Projects/zephyr/soc/nuvoton/npcm/Kconfig.sysbuild"
osource "G:/Zephyr_Projects/zephyr/soc/nordic/Kconfig.sysbuild"
osource "G:/Zephyr_Projects/zephyr/soc/neorv32/Kconfig.sysbuild"
osource "G:/Zephyr_Projects/zephyr/soc/native/inf_clock/Kconfig.sysbuild"
osource "G:/Zephyr_Projects/zephyr/soc/microchip/sam/sama7/Kconfig.sysbuild"
osource "G:/Zephyr_Projects/zephyr/soc/microchip/sam/sam_d5x_e5x/Kconfig.sysbuild"
osource "G:/Zephyr_Projects/zephyr/soc/microchip/pic64/Kconfig.sysbuild"
osource "G:/Zephyr_Projects/zephyr/soc/microchip/pic32c/pic32cz_ca/Kconfig.sysbuild"
osource "G:/Zephyr_Projects/zephyr/soc/microchip/pic32c/pic32cx_sg/Kconfig.sysbuild"
osource "G:/Zephyr_Projects/zephyr/soc/microchip/pic32c/pic32cm_pl/Kconfig.sysbuild"
osource "G:/Zephyr_Projects/zephyr/soc/microchip/pic32c/pic32cm_jh/Kconfig.sysbuild"
osource "G:/Zephyr_Projects/zephyr/soc/microchip/miv/Kconfig.sysbuild"
osource "G:/Zephyr_Projects/zephyr/soc/microchip/mec/Kconfig.sysbuild"
osource "G:/Zephyr_Projects/zephyr/soc/mediatek/mt8xxx/Kconfig.sysbuild"
osource "G:/Zephyr_Projects/zephyr/soc/lowrisc/opentitan/Kconfig.sysbuild"
osource "G:/Zephyr_Projects/zephyr/soc/litex/litex_vexriscv/Kconfig.sysbuild"
osource "G:/Zephyr_Projects/zephyr/soc/ite/ec/Kconfig.sysbuild"
osource "G:/Zephyr_Projects/zephyr/soc/intel/wildcat_lake/Kconfig.sysbuild"
osource "G:/Zephyr_Projects/zephyr/soc/intel/raptor_lake/Kconfig.sysbuild"
osource "G:/Zephyr_Projects/zephyr/soc/intel/panther_lake/Kconfig.sysbuild"
osource "G:/Zephyr_Projects/zephyr/soc/intel/lakemont/Kconfig.sysbuild"
osource "G:/Zephyr_Projects/zephyr/soc/intel/intel_socfpga_std/Kconfig.sysbuild"
osource "G:/Zephyr_Projects/zephyr/soc/intel/intel_socfpga/Kconfig.sysbuild"
osource "G:/Zephyr_Projects/zephyr/soc/intel/intel_niosv/Kconfig.sysbuild"
osource "G:/Zephyr_Projects/zephyr/soc/intel/intel_ish/Kconfig.sysbuild"
osource "G:/Zephyr_Projects/zephyr/soc/intel/intel_adsp/Kconfig.sysbuild"
osource "G:/Zephyr_Projects/zephyr/soc/intel/elkhart_lake/Kconfig.sysbuild"
osource "G:/Zephyr_Projects/zephyr/soc/intel/atom/Kconfig.sysbuild"
osource "G:/Zephyr_Projects/zephyr/soc/intel/apollo_lake/Kconfig.sysbuild"
osource "G:/Zephyr_Projects/zephyr/soc/intel/alder_lake/Kconfig.sysbuild"
osource "G:/Zephyr_Projects/zephyr/soc/infineon/psoc4/Kconfig.sysbuild"
osource "G:/Zephyr_Projects/zephyr/soc/infineon/edge/Kconfig.sysbuild"
osource "G:/Zephyr_Projects/zephyr/soc/infineon/cat3/Kconfig.sysbuild"
osource "G:/Zephyr_Projects/zephyr/soc/infineon/cat1c/Kconfig.sysbuild"
osource "G:/Zephyr_Projects/zephyr/soc/infineon/cat1b/Kconfig.sysbuild"
osource "G:/Zephyr_Projects/zephyr/soc/infineon/cat1a/Kconfig.sysbuild"
osource "G:/Zephyr_Projects/zephyr/soc/gd/gd32/Kconfig.sysbuild"
osource "G:/Zephyr_Projects/zephyr/soc/gaisler/leon3/Kconfig.sysbuild"
osource "G:/Zephyr_Projects/zephyr/soc/gaisler/gr716a/Kconfig.sysbuild"
osource "G:/Zephyr_Projects/zephyr/soc/focaltech/Kconfig.sysbuild"
osource "G:/Zephyr_Projects/zephyr/soc/espressif/Kconfig.sysbuild"
osource "G:/Zephyr_Projects/zephyr/soc/ene/kb1200/Kconfig.sysbuild"
osource "G:/Zephyr_Projects/zephyr/soc/ene/kb106x/Kconfig.sysbuild"
osource "G:/Zephyr_Projects/zephyr/soc/elan/em32f967/Kconfig.sysbuild"
osource "G:/Zephyr_Projects/zephyr/soc/egis/Kconfig.sysbuild"
osource "G:/Zephyr_Projects/zephyr/soc/efinix/sapphire/Kconfig.sysbuild"
osource "G:/Zephyr_Projects/zephyr/soc/cdns/xtensa_sample_controller/Kconfig.sysbuild"
osource "G:/Zephyr_Projects/zephyr/soc/cdns/sample_controller32/Kconfig.sysbuild"
osource "G:/Zephyr_Projects/zephyr/soc/cdns/dc233c/Kconfig.sysbuild"
osource "G:/Zephyr_Projects/zephyr/soc/brcm/bcmvk/Kconfig.sysbuild"
osource "G:/Zephyr_Projects/zephyr/soc/brcm/bcm2712/Kconfig.sysbuild"
osource "G:/Zephyr_Projects/zephyr/soc/brcm/bcm2711/Kconfig.sysbuild"
osource "G:/Zephyr_Projects/zephyr/soc/blackberry/qnxhv_vm/Kconfig.sysbuild"
osource "G:/Zephyr_Projects/zephyr/soc/bflb/Kconfig.sysbuild"
osource "G:/Zephyr_Projects/zephyr/soc/atmel/sam0/Kconfig.sysbuild"
osource "G:/Zephyr_Projects/zephyr/soc/atmel/sam/Kconfig.sysbuild"
osource "G:/Zephyr_Projects/zephyr/soc/aspeed/Kconfig.sysbuild"
osource "G:/Zephyr_Projects/zephyr/soc/arm/Kconfig.sysbuild"
osource "G:/Zephyr_Projects/zephyr/soc/arm/beetle/Kconfig.sysbuild"
osource "G:/Zephyr_Projects/zephyr/soc/antmicro/myra/Kconfig.sysbuild"
osource "G:/Zephyr_Projects/zephyr/soc/andestech/Kconfig.sysbuild"
osource "G:/Zephyr_Projects/zephyr/soc/amd/acp_6_0/Kconfig.sysbuild"
osource "G:/Zephyr_Projects/zephyr/soc/ambiq/Kconfig.sysbuild"
osource "G:/Zephyr_Projects/zephyr/soc/allwinner/sun8i_h3/Kconfig.sysbuild"
osource "G:/Zephyr_Projects/zephyr/soc/alif/ensemble/Kconfig.sysbuild"
osource "G:/Zephyr_Projects/zephyr/soc/aesc/Kconfig.sysbuild"
osource "G:/Zephyr_Projects/zephyr/soc/adi/max32/Kconfig.sysbuild"
```
